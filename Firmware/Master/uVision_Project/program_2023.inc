/*  Module 0  ,   Module 1  ,   Module 2  ,   Module 3  ,   Module 4  ,   Module 5   */
{         6794,      1654825,       146487,       710545,      2645447,      2054275 }, /* Socket 0 Cue 0 */
{      1654825,      2173052,      1654825,      1843588,      2645572,      2054275 }, /* Socket 0 Cue 1 */
{      2566720,      1254102,      2160297,      2548942,      2645697,      2054275 }, /* Socket 0 Cue 2 */
{      1548012,      1898266,       104094,        91666,      2645822,      2054275 }, /* Socket 0 Cue 3 */
{      1433222,      1433294,       808755,       468728,      2645947,      2054275 }, /* Socket 0 Cue 4 */
{      1582967,      3077197,       753356,        54321,      2646072,      2054275 }, /* Socket 0 Cue 5 */
{      2184925,      1732028,      1433079,      2714132,      2646197,      2054275 }, /* Socket 0 Cue 6 */
{      2765481,      1830116,      2734453,       327715,      2601669,      1966579 }, /* Socket 0 Cue 7 */
{      2862246,      2510148,            0,      2868564,      2601669,      1966579 }, /* Socket 0 Cue 8 */
{      1458655,      1333726,       602951,      2603124,      2601669,      1966579 }, /* Socket 0 Cue 9 */
{      1318714,      1172757,       505980,      3005273,      2601669,      1966579 }, /* Socket 0 Cue 10 */
{      2159767,      1137080,      1597764,      2649472,      2601669,      1966579 }, /* Socket 0 Cue 11 */
{      2235571,      1428506,      2874231,      2771010,      2601669,      1966579 }, /* Socket 0 Cue 12 */
{       933496,      2734494,      2840862,      1428006,      2601669,      1966579 }, /* Socket 0 Cue 13 */
{       148633,      1785352, (uint32_t)-1, (uint32_t)-1,      2766916,      2601669 }, /* Socket 0 Cue 14 */
{ (uint32_t)-1,      2235351, (uint32_t)-1, (uint32_t)-1,      2767041,      2601669 }, /* Socket 0 Cue 15 */
{      3005273,      1433508,      1405865,      2886404,      2767166,      2601669 }, /* Socket 1 Cue 0 */
{        91666,      2781192,      1007622,      2886404,      2767291,      2601669 }, /* Socket 1 Cue 1 */
{      2142787,      1801888,      2096760,      2886404,      2767416,      2601669 }, /* Socket 1 Cue 2 */
{      2126030,      2803675,      3053832,      2886404,      2767541,      2601669 }, /* Socket 1 Cue 3 */
{      2879640,       194998,      2232331,      2886404,      2767666,      2601669 }, /* Socket 1 Cue 4 */
{      2052039,       542975,      1654825,      2886404,      2887243,      2766135 }, /* Socket 1 Cue 5 */
{       329717,       260822,      1031556,      2886410,      2887243,      2766010 }, /* Socket 1 Cue 6 */
{      2697518,       390443,      1909273,      3080475,      2887243,      2765885 }, /* Socket 1 Cue 7 */
{      2647090,      1863272,      2052039,      3080475,      2887243,      2765760 }, /* Socket 1 Cue 8 */
{      2966434,       335797,      1684127,      3080475,      2887243,      2765635 }, /* Socket 1 Cue 9 */
{      2649472,      1654825,       338653,      3080475,      2887251,      2765510 }, /* Socket 1 Cue 10 */
{      2771010,      1234461,      1433437,      3080475,      2887251,      2765385 }, /* Socket 1 Cue 11 */
{      1427506, (uint32_t)-1,      3071402,      3080475,      2053958,      2644432 }, /* Socket 1 Cue 12 */
{ (uint32_t)-1, (uint32_t)-1,      3076976,      3080475,      2053958,      2644557 }, /* Socket 1 Cue 13 */
{ (uint32_t)-1, (uint32_t)-1, (uint32_t)-1, (uint32_t)-1,      2053958,      2644682 }, /* Socket 1 Cue 14 */
{ (uint32_t)-1, (uint32_t)-1, (uint32_t)-1, (uint32_t)-1,      2053958,      2644807 }, /* Socket 1 Cue 15 */
{      2696070,       849304,      3020663,      2696070,      2053958,      2644932 }, /* Socket 2 Cue 0 */
{      2696070,      2169833,      1787143,      2696070,      2053958,      2645057 }, /* Socket 2 Cue 1 */
{      2696070,      3051688,       486024,      2696070,      2053958,      2645182 }, /* Socket 2 Cue 2 */
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{      1001363,      2798595,      2870197, (uint32_t)-1, (uint32_t)-1, (uint32_t)-1 }, /* Socket 6 Cue 14 */
{ (uint32_t)-1,      2799029,      2872864, (uint32_t)-1, (uint32_t)-1, (uint32_t)-1 }, /* Socket 6 Cue 15 */
{ (uint32_t)-1,      2799462,      2875530, (uint32_t)-1, (uint32_t)-1, (uint32_t)-1 }, /* Socket 7 Cue 0 */
{ (uint32_t)-1,      2799895,      2878197, (uint32_t)-1, (uint32_t)-1, (uint32_t)-1 }, /* Socket 7 Cue 1 */
{ (uint32_t)-1,      2800329,      2940835, (uint32_t)-1, (uint32_t)-1, (uint32_t)-1 }, /* Socket 7 Cue 2 */
{ (uint32_t)-1,      2800762,      2945752, (uint32_t)-1, (uint32_t)-1, (uint32_t)-1 }, /* Socket 7 Cue 3 */
{ (uint32_t)-1,      2801195,      2950668, (uint32_t)-1, (uint32_t)-1, (uint32_t)-1 }, /* Socket 7 Cue 4 */
{ (uint32_t)-1,      2801629,      2955585, (uint32_t)-1, (uint32_t)-1, (uint32_t)-1 }, /* Socket 7 Cue 5 */
{ (uint32_t)-1,      2802062,      2960502, (uint32_t)-1, (uint32_t)-1, (uint32_t)-1 }, /* Socket 7 Cue 6 */
{ (uint32_t)-1,      2802495,      2965418, (uint32_t)-1, (uint32_t)-1, (uint32_t)-1 }, /* Socket 7 Cue 7 */
{ (uint32_t)-1,      2802929,      2970335, (uint32_t)-1, (uint32_t)-1, (uint32_t)-1 }, /* Socket 7 Cue 8 */
{ (uint32_t)-1,      2803362,      2975252, (uint32_t)-1, (uint32_t)-1, (uint32_t)-1 }, /* Socket 7 Cue 9 */
{ (uint32_t)-1,       965363,      2980168, (uint32_t)-1, (uint32_t)-1, (uint32_t)-1 }, /* Socket 7 Cue 10 */
{ (uint32_t)-1,       973363,      2985085, (uint32_t)-1, (uint32_t)-1, (uint32_t)-1 }, /* Socket 7 Cue 11 */
{ (uint32_t)-1,       981363,      2990002, (uint32_t)-1, (uint32_t)-1, (uint32_t)-1 }, /* Socket 7 Cue 12 */
{ (uint32_t)-1,       989363,      2994918, (uint32_t)-1, (uint32_t)-1, (uint32_t)-1 }, /* Socket 7 Cue 13 */
{ (uint32_t)-1,       997363,      2999835, (uint32_t)-1, (uint32_t)-1, (uint32_t)-1 }, /* Socket 7 Cue 14 */
{ (uint32_t)-1, (uint32_t)-1, (uint32_t)-1, (uint32_t)-1, (uint32_t)-1, (uint32_t)-1 } /* Socket 7 Cue 15 */