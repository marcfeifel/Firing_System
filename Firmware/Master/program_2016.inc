{ 415600,1654880,807510 },/* Socket 0,Cue 0 */
{ 1730000,176150,1734710 },/* Socket 0,Cue 1 */
{ 415600,23090,171290 },/* Socket 0,Cue 2 */
{ 231360,362420,1278730 },/* Socket 0,Cue 3 */
{ 1518640,23090,191000 },/* Socket 0,Cue 4 */
{ 942450,57270,765430 },/* Socket 0,Cue 5 */
{ 1142860,276680,153260 },/* Socket 0,Cue 6 */
{ 1590310,1066400,49350 },/* Socket 0,Cue 7 */
{ 912420,950670,1183440 },/* Socket 0,Cue 8 */
{ 1026950,731980,851820 },/* Socket 0,Cue 9 */
{ 1802370,659970,1637700 },/* Socket 0,Cue 10 */
{ 746890,(uint32_t)-1,1126440 },/* Socket 0,Cue 11 */
{ 652930,(uint32_t)-1,1004990 },/* Socket 0,Cue 12 */
{ (uint32_t)-1,(uint32_t)-1,960790 },/* Socket 0,Cue 13 */
{ (uint32_t)-1,(uint32_t)-1,86740 },/* Socket 0,Cue 14 */
{ (uint32_t)-1,(uint32_t)-1,(uint32_t)-1 },/* Socket 0,Cue 15 */
{ 843560,665040,22580 },/* Socket 1,Cue 0 */
{ 691810,1784000,1266990 },/* Socket 1,Cue 1 */
{ 1313400,92210,31610 },/* Socket 1,Cue 2 */
{ 511890,808040,107420 },/* Socket 1,Cue 3 */
{ 1529070,577200,422030 },/* Socket 1,Cue 4 */
{ 542030,1719090,500580 },/* Socket 1,Cue 5 */
{ 1583850,1153490,463340 },/* Socket 1,Cue 6 */
{ 264050,1640000,1780450 },/* Socket 1,Cue 7 */
{ 973150,1389490,246940 },/* Socket 1,Cue 8 */
{ 1666780,150870,117480 },/* Socket 1,Cue 9 */
{ 443250,1768840,890700 },/* Socket 1,Cue 10 */
{ 1647030,(uint32_t)-1,1742100 },/* Socket 1,Cue 11 */
{ 1716030,(uint32_t)-1,328960 },/* Socket 1,Cue 12 */
{ 1737000,(uint32_t)-1,599440 },/* Socket 1,Cue 13 */
{ 317830,(uint32_t)-1,(uint32_t)-1 },/* Socket 1,Cue 14 */
{ (uint32_t)-1,(uint32_t)-1,(uint32_t)-1 },/* Socket 1,Cue 15 */
{ 1804990,23290,1048010 },/* Socket 2,Cue 0 */
{ 1199330,1485000,23290 },/* Socket 2,Cue 1 */
{ 1368490,1343100,208570 },/* Socket 2,Cue 2 */
{ 1224340,133210,1675660 },/* Socket 2,Cue 3 */
{ 792560,1830140,774620 },/* Socket 2,Cue 4 */
{ 22300,808450,1759000 },/* Socket 2,Cue 5 */
{ 1460050,200850,1737450 },/* Socket 2,Cue 6 */
{ 1411050,308940,387170 },/* Socket 2,Cue 7 */
{ 348870,200850,293790 },/* Socket 2,Cue 8 */
{ 1504210,1752530,1479680 },/* Socket 2,Cue 9 */
{ 374760,1007740,1214290 },/* Socket 2,Cue 10 */
{ 627190,1400500,700480 },/* Socket 2,Cue 11 */
{ (uint32_t)-1,(uint32_t)-1,1417540 },/* Socket 2,Cue 12 */
{ (uint32_t)-1,(uint32_t)-1,1359240 },/* Socket 2,Cue 13 */
{ (uint32_t)-1,(uint32_t)-1,1109850 },/* Socket 2,Cue 14 */
{ (uint32_t)-1,(uint32_t)-1,1548450 },/* Socket 2,Cue 15 */
{ 208570,809180,374760 },/* Socket 3,Cue 0 */
{ 700480,1759000,1411050 },/* Socket 3,Cue 1 */
{ 387170,929090,627190 },/* Socket 3,Cue 2 */
{ 1109850,481610,1368490 },/* Socket 3,Cue 3 */
{ 293790,1694800,1804990 },/* Socket 3,Cue 4 */
{ 774620,907210,1199330 },/* Socket 3,Cue 5 */
{ 1417540,32710,348870 },/* Socket 3,Cue 6 */
{ 23290,1831620,1504210 },/* Socket 3,Cue 7 */
{ 1359240,561290,22270 },/* Socket 3,Cue 8 */
{ 1675660,1077190,792560 },/* Socket 3,Cue 9 */
{ 1214290,1640000,1460050 },/* Socket 3,Cue 10 */
{ 1479680,(uint32_t)-1,1224340 },/* Socket 3,Cue 11 */
{ 1048010,(uint32_t)-1,(uint32_t)-1 },/* Socket 3,Cue 12 */
{ 1759000,(uint32_t)-1,(uint32_t)-1 },/* Socket 3,Cue 13 */
{ 1737450,(uint32_t)-1,(uint32_t)-1 },/* Socket 3,Cue 14 */
{ 1548450,(uint32_t)-1,(uint32_t)-1 },/* Socket 3,Cue 15 */
{ 500580,1694800,1716030 },/* Socket 4,Cue 0 */
{ 1266990,477620,542010 },/* Socket 4,Cue 1 */
{ 246940,809180,843560 },/* Socket 4,Cue 2 */
{ 328960,586510,317830 },/* Socket 4,Cue 3 */
{ 1742100,929090,1666780 },/* Socket 4,Cue 4 */
{ 117480,1485000,443250 },/* Socket 4,Cue 5 */
{ 107420,1077190,1529070 },/* Socket 4,Cue 6 */
{ 22600,907210,1737000 },/* Socket 4,Cue 7 */
{ 31610,1485000,1647030 },/* Socket 4,Cue 8 */
{ 463340,563320,511890 },/* Socket 4,Cue 9 */
{ 1780450,32710,1583850 },/* Socket 4,Cue 10 */
{ 422030,(uint32_t)-1,1313400 },/* Socket 4,Cue 11 */
{ 890700,(uint32_t)-1,691810 },/* Socket 4,Cue 12 */
{ 599440,(uint32_t)-1,973150 },/* Socket 4,Cue 13 */
{ (uint32_t)-1,(uint32_t)-1,264050 },/* Socket 4,Cue 14 */
{ (uint32_t)-1,(uint32_t)-1,(uint32_t)-1 },/* Socket 4,Cue 15 */
{ 1637700,308940,415600 },/* Socket 5,Cue 0 */
{ 49350,133210,1730000 },/* Socket 5,Cue 1 */
{ 1278730,1343100,415600 },/* Socket 5,Cue 2 */
{ 86740,200850,231360 },/* Socket 5,Cue 3 */
{ 960790,23290,1518640 },/* Socket 5,Cue 4 */
{ 191000,1752530,942450 },/* Socket 5,Cue 5 */
{ 171150,1007740,912420 },/* Socket 5,Cue 6 */
{ 765430,1823840,1026950 },/* Socket 5,Cue 7 */
{ 807510,200850,1802370 },/* Socket 5,Cue 8 */
{ 851820,808450,746890 },/* Socket 5,Cue 9 */
{ 153260,1830140,652930 },/* Socket 5,Cue 10 */
{ 1004990,1400500,1590310 },/* Socket 5,Cue 11 */
{ 1126440,(uint32_t)-1,1142860 },/* Socket 5,Cue 12 */
{ 1734710,(uint32_t)-1,(uint32_t)-1 },/* Socket 5,Cue 13 */
{ 1183440,(uint32_t)-1,(uint32_t)-1 },/* Socket 5,Cue 14 */
{ (uint32_t)-1,(uint32_t)-1,(uint32_t)-1 },/* Socket 5,Cue 15 */
{ 1849150,92210,1854260 },/* Socket 6,Cue 0 */
{ (uint32_t)-1,575170,(uint32_t)-1 },/* Socket 6,Cue 1 */
{ (uint32_t)-1,1784000,(uint32_t)-1 },/* Socket 6,Cue 2 */
{ (uint32_t)-1,150870,(uint32_t)-1 },/* Socket 6,Cue 3 */
{ 383350,1640000,383350 },/* Socket 6,Cue 4 */
{ 387210,1153490,387210 },/* Socket 6,Cue 5 */
{ 405190,1768840,405190 },/* Socket 6,Cue 6 */
{ 1839680,665040,1839680 },/* Socket 6,Cue 7 */
{ 1843100,808040,1843100 },/* Socket 6,Cue 8 */
{ 383350,1389490,383350 },/* Socket 6,Cue 9 */
{ 387210,1719090,387210 },/* Socket 6,Cue 10 */
{ 405190,(uint32_t)-1,405190 },/* Socket 6,Cue 11 */
{ 1839680,(uint32_t)-1,1839680 },/* Socket 6,Cue 12 */
{ 1843100,(uint32_t)-1,1843100 },/* Socket 6,Cue 13 */
{ (uint32_t)-1,(uint32_t)-1,(uint32_t)-1 },/* Socket 6,Cue 14 */
{ (uint32_t)-1,(uint32_t)-1,(uint32_t)-1 },/* Socket 6,Cue 15 */
{ 378070,57270,1835100 },/* Socket 7,Cue 0 */
{ 407870,731980,1835100 },/* Socket 7,Cue 1 */
{ 687490,23090,1835100 },/* Socket 7,Cue 2 */
{ 868000,362420,1835100 },/* Socket 7,Cue 3 */
{ 378070,276680,1835100 },/* Socket 7,Cue 4 */
{ 407770,176150,1835100 },/* Socket 7,Cue 5 */
{ 687490,1654880,1835100 },/* Socket 7,Cue 6 */
{ 868000,1066400,1835100 },/* Socket 7,Cue 7 */
{ 1088860,950670,1835100 },/* Socket 7,Cue 8 */
{ 1088880,950670,1835100 },/* Socket 7,Cue 9 */
{ 1835100,659970,(uint32_t)-1 },/* Socket 7,Cue 10 */
{ (uint32_t)-1,(uint32_t)-1,(uint32_t)-1 },/* Socket 7,Cue 11 */
{ (uint32_t)-1,(uint32_t)-1,(uint32_t)-1 },/* Socket 7,Cue 12 */
{ (uint32_t)-1,(uint32_t)-1,(uint32_t)-1 },/* Socket 7,Cue 13 */
{ (uint32_t)-1,(uint32_t)-1,(uint32_t)-1 },/* Socket 7,Cue 14 */
{ (uint32_t)-1,(uint32_t)-1,(uint32_t)-1 },/* Socket 7,Cue 15 */
