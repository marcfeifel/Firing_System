	/*  Module 0  ,   Module 1  ,   Module 2  ,   Module 3  ,   Module 4  ,   Module 5   */
{      2024392,       109292,      1993536,       523710,      1948982, (uint32_t)-1 }, /* Socket 0 Cue 0 */
{       334654,       313254,      1552356,       540082,       516419, (uint32_t)-1 }, /* Socket 0 Cue 1 */
{      1016902,       852793,       134524,       548236,      1265483, (uint32_t)-1 }, /* Socket 0 Cue 2 */
{       609855,       344716,      1939664,       818876,       611998, (uint32_t)-1 }, /* Socket 0 Cue 3 */
{      1629170,      1497173,       264861,      1215536,       348804, (uint32_t)-1 }, /* Socket 0 Cue 4 */
{      1073402,      1762636,      1796455,      1869769,       635670, (uint32_t)-1 }, /* Socket 0 Cue 5 */
{       948746,       418603,       451151,        23865,      1048463, (uint32_t)-1 }, /* Socket 0 Cue 6 */
{      1483770,       463116,       860459,       745230,      1283332, (uint32_t)-1 }, /* Socket 0 Cue 7 */
{      1588610,      1478410,      1517759,      1311757,       961503, (uint32_t)-1 }, /* Socket 0 Cue 8 */
{      1838265,      1657601,       610926,       780551,      1709160, (uint32_t)-1 }, /* Socket 0 Cue 9 */
{       887849,      1744655,      1637907,       202513,      1132178, (uint32_t)-1 }, /* Socket 0 Cue 10 */
{ (uint32_t)-1,      1355976,      1853641,      1451326,      1075152, (uint32_t)-1 }, /* Socket 0 Cue 11 */
{ (uint32_t)-1,      1987583,      1102199,      1185133,      2024649, (uint32_t)-1 }, /* Socket 0 Cue 12 */
{ (uint32_t)-1,      1431785,       226157,       578573,      1455867, (uint32_t)-1 }, /* Socket 0 Cue 13 */
{ (uint32_t)-1,      2006787,      1074152,        52642, (uint32_t)-1, (uint32_t)-1 }, /* Socket 0 Cue 14 */
{ (uint32_t)-1, (uint32_t)-1,      1896905,       903726, (uint32_t)-1, (uint32_t)-1 }, /* Socket 0 Cue 15 */
{      1898627,       898926,       255131,      1151516,      1916132, (uint32_t)-1 }, /* Socket 1 Cue 0 */
{       502900,      1151516,      1370104,      1744655,      1995428, (uint32_t)-1 }, /* Socket 1 Cue 1 */
{       495344,       610569,      2018944,       611641,       495344, (uint32_t)-1 }, /* Socket 1 Cue 2 */
{       359217,        36651,       378096,      1073652,       830342, (uint32_t)-1 }, /* Socket 1 Cue 3 */
{      1677386,      1395358,       838610,       380684,       502900, (uint32_t)-1 }, /* Socket 1 Cue 4 */
{       803190,       993589,       168928,      1712556,      1898627, (uint32_t)-1 }, /* Socket 1 Cue 5 */
{      1995428,      1116525,      1528074,      1116525,      1677386, (uint32_t)-1 }, /* Socket 1 Cue 6 */
{      1916132,      1245257,       844024,      1395358,       803190, (uint32_t)-1 }, /* Socket 1 Cue 7 */
{       830342,      1075402,        13271,       898926,      1841312, (uint32_t)-1 }, /* Socket 1 Cue 8 */
{       459076,       380684,       852991,       717296,       459076, (uint32_t)-1 }, /* Socket 1 Cue 9 */
{       656512,       717024,       825990,       996680,       656512, (uint32_t)-1 }, /* Socket 1 Cue 10 */
{       825990,      1471366,       798620,       355483,       825990, (uint32_t)-1 }, /* Socket 1 Cue 11 */
{       825990,      1601416, (uint32_t)-1,       417063,       825990, (uint32_t)-1 }, /* Socket 1 Cue 12 */
{       252525,       355483, (uint32_t)-1,      1471366,       252525, (uint32_t)-1 }, /* Socket 1 Cue 13 */
{       252525,       415816, (uint32_t)-1,      1245257,       252525, (uint32_t)-1 }, /* Socket 1 Cue 14 */
{ (uint32_t)-1,      1712556, (uint32_t)-1,      1601416, (uint32_t)-1, (uint32_t)-1 }, /* Socket 1 Cue 15 */
{      1048463,       193338,       134524,      2006787,       948746, (uint32_t)-1 }, /* Socket 2 Cue 0 */
{      1709160,      1185133,      1796455,      1987583,      1483770, (uint32_t)-1 }, /* Socket 2 Cue 1 */
{       516419,      1451326,       445723,      1431785,      1588610, (uint32_t)-1 }, /* Socket 2 Cue 2 */
{       348804,       770313,      1637907,      1355976,      2024392, (uint32_t)-1 }, /* Socket 2 Cue 3 */
{      1283332,       578573,      1517759,        36651,      1838265, (uint32_t)-1 }, /* Socket 2 Cue 4 */
{       635670,       544544,      1939664,       313254,      1629170, (uint32_t)-1 }, /* Socket 2 Cue 5 */
{       961503,       523710,       611284,       470484,      1016902, (uint32_t)-1 }, /* Socket 2 Cue 6 */
{       610212,      1869769,       226157,       852793,       612355, (uint32_t)-1 }, /* Socket 2 Cue 7 */
{      1265483,      1311757,      1896905,       344716,       887849, (uint32_t)-1 }, /* Socket 2 Cue 8 */
{      1948982,        52642,      1853641,      1478410,       330568, (uint32_t)-1 }, /* Socket 2 Cue 9 */
{      1455867,       818876,      1102199,      1496599,      1074902, (uint32_t)-1 }, /* Socket 2 Cue 10 */
{      1132178,       563642,       860459,       109292, (uint32_t)-1, (uint32_t)-1 }, /* Socket 2 Cue 11 */
{      1073902,       903726,      1552356,      1657601, (uint32_t)-1, (uint32_t)-1 }, /* Socket 2 Cue 12 */
{      2024649,       761155,      1074652,      1762636, (uint32_t)-1, (uint32_t)-1 }, /* Socket 2 Cue 13 */
{ (uint32_t)-1,      1215536,      1993536,       418603, (uint32_t)-1, (uint32_t)-1 }, /* Socket 2 Cue 14 */
{ (uint32_t)-1,        23865,       264861, (uint32_t)-1, (uint32_t)-1, (uint32_t)-1 }, /* Socket 2 Cue 15 */
{       675120,       705849,       907799,       735297,       907799, (uint32_t)-1 }, /* Socket 3 Cue 0 */
{       675370,       705849,       907832,       735592,       907832, (uint32_t)-1 }, /* Socket 3 Cue 1 */
{       675620,       705849,       907866,       735834,       907866, (uint32_t)-1 }, /* Socket 3 Cue 2 */
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{      2029409, (uint32_t)-1, (uint32_t)-1, (uint32_t)-1,       104285, (uint32_t)-1 }, /* Socket 6 Cue 15 */
{ (uint32_t)-1, (uint32_t)-1, (uint32_t)-1, (uint32_t)-1, (uint32_t)-1, (uint32_t)-1 }, /* Socket 7 Cue 0 */
{ (uint32_t)-1, (uint32_t)-1, (uint32_t)-1, (uint32_t)-1, (uint32_t)-1, (uint32_t)-1 }, /* Socket 7 Cue 1 */
{ (uint32_t)-1, (uint32_t)-1, (uint32_t)-1, (uint32_t)-1, (uint32_t)-1, (uint32_t)-1 }, /* Socket 7 Cue 2 */
{ (uint32_t)-1, (uint32_t)-1, (uint32_t)-1, (uint32_t)-1, (uint32_t)-1, (uint32_t)-1 }, /* Socket 7 Cue 3 */
{ (uint32_t)-1, (uint32_t)-1, (uint32_t)-1, (uint32_t)-1, (uint32_t)-1, (uint32_t)-1 }, /* Socket 7 Cue 4 */
{ (uint32_t)-1, (uint32_t)-1, (uint32_t)-1, (uint32_t)-1, (uint32_t)-1, (uint32_t)-1 }, /* Socket 7 Cue 5 */
{ (uint32_t)-1, (uint32_t)-1, (uint32_t)-1, (uint32_t)-1, (uint32_t)-1, (uint32_t)-1 }, /* Socket 7 Cue 6 */
{ (uint32_t)-1, (uint32_t)-1, (uint32_t)-1, (uint32_t)-1, (uint32_t)-1, (uint32_t)-1 }, /* Socket 7 Cue 7 */
{ (uint32_t)-1, (uint32_t)-1, (uint32_t)-1, (uint32_t)-1, (uint32_t)-1, (uint32_t)-1 }, /* Socket 7 Cue 8 */
{ (uint32_t)-1, (uint32_t)-1, (uint32_t)-1, (uint32_t)-1, (uint32_t)-1, (uint32_t)-1 }, /* Socket 7 Cue 9 */
{ (uint32_t)-1, (uint32_t)-1, (uint32_t)-1, (uint32_t)-1, (uint32_t)-1, (uint32_t)-1 }, /* Socket 7 Cue 10 */
{ (uint32_t)-1, (uint32_t)-1, (uint32_t)-1, (uint32_t)-1, (uint32_t)-1, (uint32_t)-1 }, /* Socket 7 Cue 11 */
{ (uint32_t)-1, (uint32_t)-1, (uint32_t)-1, (uint32_t)-1, (uint32_t)-1, (uint32_t)-1 }, /* Socket 7 Cue 12 */
{ (uint32_t)-1, (uint32_t)-1, (uint32_t)-1, (uint32_t)-1, (uint32_t)-1, (uint32_t)-1 }, /* Socket 7 Cue 13 */
{ (uint32_t)-1, (uint32_t)-1, (uint32_t)-1, (uint32_t)-1, (uint32_t)-1, (uint32_t)-1 }, /* Socket 7 Cue 14 */
{ (uint32_t)-1, (uint32_t)-1, (uint32_t)-1, (uint32_t)-1, (uint32_t)-1, (uint32_t)-1 } /* Socket 7 Cue 15 */
