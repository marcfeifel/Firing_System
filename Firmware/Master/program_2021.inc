/*  Module 0  ,   Module 1  ,   Module 2  ,   Module 3  ,   Module 4  ,   Module 5   */
{       199559,      1224305,      1748773,      2068231, (uint32_t)-1, (uint32_t)-1 }, /* Socket 0 Cue 0 */
{      2055415,      1352943,      1628032,      1012703, (uint32_t)-1, (uint32_t)-1 }, /* Socket 0 Cue 1 */
{      1789520,      1919593,      1562103,       299263, (uint32_t)-1, (uint32_t)-1 }, /* Socket 0 Cue 2 */
{       386079,      1113360, (uint32_t)-1,       589128, (uint32_t)-1, (uint32_t)-1 }, /* Socket 0 Cue 3 */
{      1561728,      1734473,      1390349,       197374, (uint32_t)-1, (uint32_t)-1 }, /* Socket 0 Cue 4 */
{       165624,      1585604,      2130085,       170629, (uint32_t)-1, (uint32_t)-1 }, /* Socket 0 Cue 5 */
{       359365,      1561165,        37791,       362865, (uint32_t)-1, (uint32_t)-1 }, /* Socket 0 Cue 6 */
{        38346,      1851745,      1314638,        41124, (uint32_t)-1, (uint32_t)-1 }, /* Socket 0 Cue 7 */
{      1050260,       360143,       670290,       496015, (uint32_t)-1, (uint32_t)-1 }, /* Socket 0 Cue 8 */
{       589128,      2300195,      1852545,       386079, (uint32_t)-1, (uint32_t)-1 }, /* Socket 0 Cue 9 */
{      1749023,        38902,       994856,      1561353, (uint32_t)-1, (uint32_t)-1 }, /* Socket 0 Cue 10 */
{       142272,      1923080,       361698,       633216, (uint32_t)-1, (uint32_t)-1 }, /* Socket 0 Cue 11 */
{       644553,      1833936,        21549,      1749773, (uint32_t)-1, (uint32_t)-1 }, /* Socket 0 Cue 12 */
{      1631543,      1849620,        21549,      1668383, (uint32_t)-1, (uint32_t)-1 }, /* Socket 0 Cue 13 */
{      1668383,      2332412,      1835096,      1631543, (uint32_t)-1, (uint32_t)-1 }, /* Socket 0 Cue 14 */
{      1449578,       843070,      1849620,      1451578, (uint32_t)-1, (uint32_t)-1 }, /* Socket 0 Cue 15 */
{        39457,      1162023,      1911098,      1099339, (uint32_t)-1, (uint32_t)-1 }, /* Socket 1 Cue 0 */
{      1520709,      2027032,      1562290,      1113478, (uint32_t)-1, (uint32_t)-1 }, /* Socket 1 Cue 1 */
{      1485280,        36680,      1852812,      1113311, (uint32_t)-1, (uint32_t)-1 }, /* Socket 1 Cue 2 */
{       359754,      1997918,      1749523,      1113145, (uint32_t)-1, (uint32_t)-1 }, /* Socket 1 Cue 3 */
{        57887,       550412,       362087,      1112978, (uint32_t)-1, (uint32_t)-1 }, /* Socket 1 Cue 4 */
{      1561540,       254710,      1365922,      1112811, (uint32_t)-1, (uint32_t)-1 }, /* Socket 1 Cue 5 */
{      1733363,      1851212,        40568,      1112645, (uint32_t)-1, (uint32_t)-1 }, /* Socket 1 Cue 6 */
{      1272771,       360532,      1113360,      1112478, (uint32_t)-1, (uint32_t)-1 }, /* Socket 1 Cue 7 */
{       450133,      1769867,      1701829,       243239, (uint32_t)-1, (uint32_t)-1 }, /* Socket 1 Cue 8 */
{      1377152,      1561915,      1224305,       243239, (uint32_t)-1, (uint32_t)-1 }, /* Socket 1 Cue 9 */
{       774801,      1405618,       858673,       243239, (uint32_t)-1, (uint32_t)-1 }, /* Socket 1 Cue 10 */
{      1893180,      2110729, (uint32_t)-1,       243239, (uint32_t)-1, (uint32_t)-1 }, /* Socket 1 Cue 11 */
{      1851479,      1628032, (uint32_t)-1,       243239, (uint32_t)-1, (uint32_t)-1 }, /* Socket 1 Cue 12 */
{      1994335,      1731258, (uint32_t)-1,       243239, (uint32_t)-1, (uint32_t)-1 }, /* Socket 1 Cue 13 */
{ (uint32_t)-1,        10171, (uint32_t)-1,       243239, (uint32_t)-1, (uint32_t)-1 }, /* Socket 1 Cue 14 */
{ (uint32_t)-1,        10171, (uint32_t)-1, (uint32_t)-1, (uint32_t)-1, (uint32_t)-1 }, /* Socket 1 Cue 15 */
{      1099339,       110932,      1271376,       726145, (uint32_t)-1, (uint32_t)-1 }, /* Socket 2 Cue 0 */
{       243239,      1562665,      1562478,       727374, (uint32_t)-1, (uint32_t)-1 }, /* Socket 2 Cue 1 */
{       243239,      1749273,        36124,       728602, (uint32_t)-1, (uint32_t)-1 }, /* Socket 2 Cue 2 */
{       243239,      1852012,       934496,       729831, (uint32_t)-1, (uint32_t)-1 }, /* Socket 2 Cue 3 */
{       243239,      2135086,      1737707,       731060, (uint32_t)-1, (uint32_t)-1 }, /* Socket 2 Cue 4 */
{       243239,      2190193,       806150,       732288, (uint32_t)-1, (uint32_t)-1 }, /* Socket 2 Cue 5 */
{       243239,       360921,      1455797,       724916, (uint32_t)-1, (uint32_t)-1 }, /* Socket 2 Cue 6 */
{       243239,       413303,        64904,      1885819, (uint32_t)-1, (uint32_t)-1 }, /* Socket 2 Cue 7 */
{       707715,      2195559,      1405618,      1886407, (uint32_t)-1, (uint32_t)-1 }, /* Socket 2 Cue 8 */
{       708944,      1333794,       362476,      1886995, (uint32_t)-1, (uint32_t)-1 }, /* Socket 2 Cue 9 */
{       710172,        40013,      1487029,      1887584, (uint32_t)-1, (uint32_t)-1 }, /* Socket 2 Cue 10 */
{       711401,       216046,      1852279,      1888172, (uint32_t)-1, (uint32_t)-1 }, /* Socket 2 Cue 11 */
{       712630,      1094041,      1663966,      1888760, (uint32_t)-1, (uint32_t)-1 }, /* Socket 2 Cue 12 */
{       713858,      1985593,      1994086, (uint32_t)-1, (uint32_t)-1, (uint32_t)-1 }, /* Socket 2 Cue 13 */
{       715087, (uint32_t)-1,      1923937, (uint32_t)-1, (uint32_t)-1, (uint32_t)-1 }, /* Socket 2 Cue 14 */
{      1113478, (uint32_t)-1, (uint32_t)-1, (uint32_t)-1, (uint32_t)-1, (uint32_t)-1 }, /* Socket 2 Cue 15 */
{      1113311,      2266259,      1981393, (uint32_t)-1, (uint32_t)-1, (uint32_t)-1 }, /* Socket 3 Cue 0 */
{      1113145,      1200171,       106916, (uint32_t)-1, (uint32_t)-1, (uint32_t)-1 }, /* Socket 3 Cue 1 */
{      1112978,      1655600,       106955, (uint32_t)-1, (uint32_t)-1, (uint32_t)-1 }, /* Socket 3 Cue 2 */
{      1112811,       519917,       106993, (uint32_t)-1, (uint32_t)-1, (uint32_t)-1 }, /* Socket 3 Cue 3 */
{      1112645,      2242121,       107032, (uint32_t)-1, (uint32_t)-1, (uint32_t)-1 }, /* Socket 3 Cue 4 */
{ (uint32_t)-1,       333586,       107070, (uint32_t)-1, (uint32_t)-1, (uint32_t)-1 }, /* Socket 3 Cue 5 */
{      1112478,       361309,       107109, (uint32_t)-1, (uint32_t)-1, (uint32_t)-1 }, /* Socket 3 Cue 6 */
{      1878760,        37235,       107147, (uint32_t)-1, (uint32_t)-1, (uint32_t)-1 }, /* Socket 3 Cue 7 */
{      1879348,      1730096,       742118, (uint32_t)-1, (uint32_t)-1, (uint32_t)-1 }, /* Socket 3 Cue 8 */
{      1879936,       196785,       743346, (uint32_t)-1, (uint32_t)-1, (uint32_t)-1 }, /* Socket 3 Cue 9 */
{      1880525,       982551,       744575, (uint32_t)-1, (uint32_t)-1, (uint32_t)-1 }, /* Socket 3 Cue 10 */
{      1881113,      2133571,       745804, (uint32_t)-1, (uint32_t)-1, (uint32_t)-1 }, /* Socket 3 Cue 11 */
{      1881701,      2135942,       747032, (uint32_t)-1, (uint32_t)-1, (uint32_t)-1 }, /* Socket 3 Cue 12 */
{ (uint32_t)-1,      1084874,       748261, (uint32_t)-1, (uint32_t)-1, (uint32_t)-1 }, /* Socket 3 Cue 13 */
{ (uint32_t)-1,      1114198,       749490, (uint32_t)-1, (uint32_t)-1, (uint32_t)-1 }, /* Socket 3 Cue 14 */
{ (uint32_t)-1, (uint32_t)-1,       759319, (uint32_t)-1, (uint32_t)-1, (uint32_t)-1 }, /* Socket 3 Cue 15 */
{      1981393,      1990046,       760548, (uint32_t)-1, (uint32_t)-1, (uint32_t)-1 }, /* Socket 4 Cue 0 */
{       733604,      1089843,       761776, (uint32_t)-1, (uint32_t)-1, (uint32_t)-1 }, /* Socket 4 Cue 1 */
{       734746,      1089843,       763005, (uint32_t)-1, (uint32_t)-1, (uint32_t)-1 }, /* Socket 4 Cue 2 */
{       735974,      1089843,       764234, (uint32_t)-1, (uint32_t)-1, (uint32_t)-1 }, /* Socket 4 Cue 3 */
{       737203,      1089843,       765462, (uint32_t)-1, (uint32_t)-1, (uint32_t)-1 }, /* Socket 4 Cue 4 */
{       738432,      1089843,       766691, (uint32_t)-1, (uint32_t)-1, (uint32_t)-1 }, /* Socket 4 Cue 5 */
{       739660,      1089843,      1841862, (uint32_t)-1, (uint32_t)-1, (uint32_t)-1 }, /* Socket 4 Cue 6 */
{       740889,      1089843,      1842208, (uint32_t)-1, (uint32_t)-1, (uint32_t)-1 }, /* Socket 4 Cue 7 */
{       106647,      1989792,      1842901, (uint32_t)-1, (uint32_t)-1, (uint32_t)-1 }, /* Socket 4 Cue 8 */
{       106685,      1989792,      1843247, (uint32_t)-1, (uint32_t)-1, (uint32_t)-1 }, /* Socket 4 Cue 9 */
{       106724,      1989792,      1843593, (uint32_t)-1, (uint32_t)-1, (uint32_t)-1 }, /* Socket 4 Cue 10 */
{       106762,      1989792,      1843939, (uint32_t)-1, (uint32_t)-1, (uint32_t)-1 }, /* Socket 4 Cue 11 */
{       106801,      1989792,      1842554, (uint32_t)-1, (uint32_t)-1, (uint32_t)-1 }, /* Socket 4 Cue 12 */
{       106839,      1989792, (uint32_t)-1, (uint32_t)-1, (uint32_t)-1, (uint32_t)-1 }, /* Socket 4 Cue 13 */
{       106878,      1989792, (uint32_t)-1, (uint32_t)-1, (uint32_t)-1, (uint32_t)-1 }, /* Socket 4 Cue 14 */
{       750718,       716316, (uint32_t)-1, (uint32_t)-1, (uint32_t)-1, (uint32_t)-1 }, /* Socket 4 Cue 15 */
{       751947,       717544,      1100000, (uint32_t)-1, (uint32_t)-1, (uint32_t)-1 }, /* Socket 5 Cue 0 */
{       753176,       718773,      1102200, (uint32_t)-1, (uint32_t)-1, (uint32_t)-1 }, /* Socket 5 Cue 1 */
{       754404,       720002,      1104400, (uint32_t)-1, (uint32_t)-1, (uint32_t)-1 }, /* Socket 5 Cue 2 */
{       755633,       721230,      1106600, (uint32_t)-1, (uint32_t)-1, (uint32_t)-1 }, /* Socket 5 Cue 3 */
{       756862, (uint32_t)-1,      1108800, (uint32_t)-1, (uint32_t)-1, (uint32_t)-1 }, /* Socket 5 Cue 4 */
{       758090, (uint32_t)-1,       766660, (uint32_t)-1, (uint32_t)-1, (uint32_t)-1 }, /* Socket 5 Cue 5 */
{      1839439,       722459,       770539, (uint32_t)-1, (uint32_t)-1, (uint32_t)-1 }, /* Socket 5 Cue 6 */
{      1839785,       723688,       772851, (uint32_t)-1, (uint32_t)-1, (uint32_t)-1 }, /* Socket 5 Cue 7 */
{      1840131,      1882289,       981308, (uint32_t)-1, (uint32_t)-1, (uint32_t)-1 }, /* Socket 5 Cue 8 */
{      1840477,      1882878,       983086, (uint32_t)-1, (uint32_t)-1, (uint32_t)-1 }, /* Socket 5 Cue 9 */
{      1840824,      1883466,       984864, (uint32_t)-1, (uint32_t)-1, (uint32_t)-1 }, /* Socket 5 Cue 10 */
{      1841170,      1884054,       988419, (uint32_t)-1, (uint32_t)-1, (uint32_t)-1 }, /* Socket 5 Cue 11 */
{      1841516,      1884642,       975975, (uint32_t)-1, (uint32_t)-1, (uint32_t)-1 }, /* Socket 5 Cue 12 */
{ (uint32_t)-1,      1885231,       979531, (uint32_t)-1, (uint32_t)-1, (uint32_t)-1 }, /* Socket 5 Cue 13 */
{ (uint32_t)-1, (uint32_t)-1,      1072631, (uint32_t)-1, (uint32_t)-1, (uint32_t)-1 }, /* Socket 5 Cue 14 */
{ (uint32_t)-1, (uint32_t)-1,      1074126, (uint32_t)-1, (uint32_t)-1, (uint32_t)-1 }, /* Socket 5 Cue 15 */
{ (uint32_t)-1, (uint32_t)-1,      1063409, (uint32_t)-1, (uint32_t)-1, (uint32_t)-1 }, /* Socket 6 Cue 0 */
{ (uint32_t)-1, (uint32_t)-1,      1069632, (uint32_t)-1, (uint32_t)-1, (uint32_t)-1 }, /* Socket 6 Cue 1 */
{ (uint32_t)-1, (uint32_t)-1,      1067464, (uint32_t)-1, (uint32_t)-1, (uint32_t)-1 }, /* Socket 6 Cue 2 */
{ (uint32_t)-1, (uint32_t)-1,      1071820, (uint32_t)-1, (uint32_t)-1, (uint32_t)-1 }, /* Socket 6 Cue 3 */
{ (uint32_t)-1, (uint32_t)-1,       977753, (uint32_t)-1, (uint32_t)-1, (uint32_t)-1 }, /* Socket 6 Cue 4 */
{ (uint32_t)-1, (uint32_t)-1,       986642, (uint32_t)-1, (uint32_t)-1, (uint32_t)-1 }, /* Socket 6 Cue 5 */
{ (uint32_t)-1, (uint32_t)-1,       990197, (uint32_t)-1, (uint32_t)-1, (uint32_t)-1 }, /* Socket 6 Cue 6 */
{ (uint32_t)-1, (uint32_t)-1,       991975, (uint32_t)-1, (uint32_t)-1, (uint32_t)-1 }, /* Socket 6 Cue 7 */
{ (uint32_t)-1, (uint32_t)-1,      1594285, (uint32_t)-1, (uint32_t)-1, (uint32_t)-1 }, /* Socket 6 Cue 8 */
{ (uint32_t)-1, (uint32_t)-1,      1595160, (uint32_t)-1, (uint32_t)-1, (uint32_t)-1 }, /* Socket 6 Cue 9 */
{ (uint32_t)-1, (uint32_t)-1,      1596035, (uint32_t)-1, (uint32_t)-1, (uint32_t)-1 }, /* Socket 6 Cue 10 */
{ (uint32_t)-1, (uint32_t)-1,      1613272, (uint32_t)-1, (uint32_t)-1, (uint32_t)-1 }, /* Socket 6 Cue 11 */
{ (uint32_t)-1, (uint32_t)-1,      1616507, (uint32_t)-1, (uint32_t)-1, (uint32_t)-1 }, /* Socket 6 Cue 12 */
{ (uint32_t)-1, (uint32_t)-1,      1833332, (uint32_t)-1, (uint32_t)-1, (uint32_t)-1 }, /* Socket 6 Cue 13 */
{ (uint32_t)-1, (uint32_t)-1,      1834655, (uint32_t)-1, (uint32_t)-1, (uint32_t)-1 }, /* Socket 6 Cue 14 */
{ (uint32_t)-1, (uint32_t)-1,      1835914, (uint32_t)-1, (uint32_t)-1, (uint32_t)-1 }, /* Socket 6 Cue 15 */
{ (uint32_t)-1, (uint32_t)-1, (uint32_t)-1, (uint32_t)-1, (uint32_t)-1, (uint32_t)-1 }, /* Socket 7 Cue 0 */
{ (uint32_t)-1, (uint32_t)-1, (uint32_t)-1, (uint32_t)-1, (uint32_t)-1, (uint32_t)-1 }, /* Socket 7 Cue 1 */
{ (uint32_t)-1, (uint32_t)-1, (uint32_t)-1, (uint32_t)-1, (uint32_t)-1, (uint32_t)-1 }, /* Socket 7 Cue 2 */
{ (uint32_t)-1, (uint32_t)-1, (uint32_t)-1, (uint32_t)-1, (uint32_t)-1, (uint32_t)-1 }, /* Socket 7 Cue 3 */
{ (uint32_t)-1, (uint32_t)-1, (uint32_t)-1, (uint32_t)-1, (uint32_t)-1, (uint32_t)-1 }, /* Socket 7 Cue 4 */
{ (uint32_t)-1, (uint32_t)-1, (uint32_t)-1, (uint32_t)-1, (uint32_t)-1, (uint32_t)-1 }, /* Socket 7 Cue 5 */
{ (uint32_t)-1, (uint32_t)-1, (uint32_t)-1, (uint32_t)-1, (uint32_t)-1, (uint32_t)-1 }, /* Socket 7 Cue 6 */
{ (uint32_t)-1, (uint32_t)-1, (uint32_t)-1, (uint32_t)-1, (uint32_t)-1, (uint32_t)-1 }, /* Socket 7 Cue 7 */
{ (uint32_t)-1, (uint32_t)-1, (uint32_t)-1, (uint32_t)-1, (uint32_t)-1, (uint32_t)-1 }, /* Socket 7 Cue 8 */
{ (uint32_t)-1, (uint32_t)-1, (uint32_t)-1, (uint32_t)-1, (uint32_t)-1, (uint32_t)-1 }, /* Socket 7 Cue 9 */
{ (uint32_t)-1, (uint32_t)-1, (uint32_t)-1, (uint32_t)-1, (uint32_t)-1, (uint32_t)-1 }, /* Socket 7 Cue 10 */
{ (uint32_t)-1, (uint32_t)-1, (uint32_t)-1, (uint32_t)-1, (uint32_t)-1, (uint32_t)-1 }, /* Socket 7 Cue 11 */
{ (uint32_t)-1, (uint32_t)-1, (uint32_t)-1, (uint32_t)-1, (uint32_t)-1, (uint32_t)-1 }, /* Socket 7 Cue 12 */
{ (uint32_t)-1, (uint32_t)-1, (uint32_t)-1, (uint32_t)-1, (uint32_t)-1, (uint32_t)-1 }, /* Socket 7 Cue 13 */
{ (uint32_t)-1, (uint32_t)-1, (uint32_t)-1, (uint32_t)-1, (uint32_t)-1, (uint32_t)-1 }, /* Socket 7 Cue 14 */
{ (uint32_t)-1, (uint32_t)-1, (uint32_t)-1, (uint32_t)-1, (uint32_t)-1, (uint32_t)-1 } /* Socket 7 Cue 15 */

/*
0 duplicate cues with different firing times.
0 cues found with missing firing data.
322 cues added to program.


Expected scan response:
Remote-0 scan response:
Socket 0: Q00 Q01 Q02 Q03 Q04 Q05 Q06 Q07 Q08 Q09 Q10 Q11 Q12 Q13 Q14 Q15
Socket 1: Q00 Q01 Q02 Q03 Q04 Q05 Q06 Q07 Q08 Q09 Q10 Q11 Q12 Q13
Socket 2: Q00 Q01 Q02 Q03 Q04 Q05 Q06 Q07 Q08 Q09 Q10 Q11 Q12 Q13 Q14 Q15
Socket 3: Q00 Q01 Q02 Q03 Q04     Q06 Q07 Q08 Q09 Q10 Q11 Q12
Socket 4: Q00 Q01 Q02 Q03 Q04 Q05 Q06 Q07 Q08 Q09 Q10 Q11 Q12 Q13 Q14 Q15
Socket 5: Q00 Q01 Q02 Q03 Q04 Q05 Q06 Q07 Q08 Q09 Q10 Q11 Q12
Socket 6:
Socket 7:
Remote-1 scan response:
Socket 0: Q00 Q01 Q02 Q03 Q04 Q05 Q06 Q07 Q08 Q09 Q10 Q11 Q12 Q13 Q14 Q15
Socket 1: Q00 Q01 Q02 Q03 Q04 Q05 Q06 Q07 Q08 Q09 Q10 Q11 Q12 Q13 Q14 Q15
Socket 2: Q00 Q01 Q02 Q03 Q04 Q05 Q06 Q07 Q08 Q09 Q10 Q11 Q12 Q13
Socket 3: Q00 Q01 Q02 Q03 Q04 Q05 Q06 Q07 Q08 Q09 Q10 Q11 Q12 Q13 Q14
Socket 4: Q00 Q01 Q02 Q03 Q04 Q05 Q06 Q07 Q08 Q09 Q10 Q11 Q12 Q13 Q14 Q15
Socket 5: Q00 Q01 Q02 Q03         Q06 Q07 Q08 Q09 Q10 Q11 Q12 Q13
Socket 6:
Socket 7:
Remote-2 scan response:
Socket 0: Q00 Q01 Q02     Q04 Q05 Q06 Q07 Q08 Q09 Q10 Q11 Q12 Q13 Q14 Q15
Socket 1: Q00 Q01 Q02 Q03 Q04 Q05 Q06 Q07 Q08 Q09 Q10
Socket 2: Q00 Q01 Q02 Q03 Q04 Q05 Q06 Q07 Q08 Q09 Q10 Q11 Q12 Q13 Q14
Socket 3: Q00 Q01 Q02 Q03 Q04 Q05 Q06 Q07 Q08 Q09 Q10 Q11 Q12 Q13 Q14 Q15
Socket 4: Q00 Q01 Q02 Q03 Q04 Q05 Q06 Q07 Q08 Q09 Q10 Q11 Q12
Socket 5: Q00 Q01 Q02 Q03 Q04 Q05 Q06 Q07 Q08 Q09 Q10 Q11 Q12 Q13 Q14 Q15
Socket 6: Q00 Q01 Q02 Q03 Q04 Q05 Q06 Q07 Q08 Q09 Q10 Q11 Q12 Q13 Q14 Q15
Socket 7:
Remote-3 scan response:
Socket 0: Q00 Q01 Q02 Q03 Q04 Q05 Q06 Q07 Q08 Q09 Q10 Q11 Q12 Q13 Q14 Q15
Socket 1: Q00 Q01 Q02 Q03 Q04 Q05 Q06 Q07 Q08 Q09 Q10 Q11 Q12 Q13 Q14
Socket 2: Q00 Q01 Q02 Q03 Q04 Q05 Q06 Q07 Q08 Q09 Q10 Q11 Q12
Socket 3:
Socket 4:
Socket 5:
Socket 6:
Socket 7:
Remote-4 scan response:
Socket 0:
Socket 1:
Socket 2:
Socket 3:
Socket 4:
Socket 5:
Socket 6:
Socket 7:
Remote-5 scan response:
Socket 0:
Socket 1:
Socket 2:
Socket 3:
Socket 4:
Socket 5:
Socket 6:
Socket 7:
*/