/*  Module 0  ,   Module 1  ,   Module 2  ,   Module 3  ,   Module 4  ,   Module 5   */
{       333126,        28014, (uint32_t)-1, (uint32_t)-1, (uint32_t)-1, (uint32_t)-1 }, /* Socket 0 Cue 0 */
{       517630,       548855, (uint32_t)-1, (uint32_t)-1, (uint32_t)-1, (uint32_t)-1 }, /* Socket 0 Cue 1 */
{       680351,       801879, (uint32_t)-1, (uint32_t)-1, (uint32_t)-1, (uint32_t)-1 }, /* Socket 0 Cue 2 */
{      1447895,      1514246, (uint32_t)-1, (uint32_t)-1, (uint32_t)-1, (uint32_t)-1 }, /* Socket 0 Cue 3 */
{       924349,       988474, (uint32_t)-1, (uint32_t)-1, (uint32_t)-1, (uint32_t)-1 }, /* Socket 0 Cue 4 */
{ (uint32_t)-1,      1049278, (uint32_t)-1, (uint32_t)-1, (uint32_t)-1, (uint32_t)-1 }, /* Socket 0 Cue 5 */
{ (uint32_t)-1,       355237, (uint32_t)-1, (uint32_t)-1, (uint32_t)-1, (uint32_t)-1 }, /* Socket 0 Cue 6 */
{ (uint32_t)-1,      1100098, (uint32_t)-1, (uint32_t)-1, (uint32_t)-1, (uint32_t)-1 }, /* Socket 0 Cue 7 */
{ (uint32_t)-1,      1245997, (uint32_t)-1, (uint32_t)-1, (uint32_t)-1, (uint32_t)-1 }, /* Socket 0 Cue 8 */
{ (uint32_t)-1, (uint32_t)-1, (uint32_t)-1, (uint32_t)-1, (uint32_t)-1, (uint32_t)-1 }, /* Socket 0 Cue 9 */
{ (uint32_t)-1, (uint32_t)-1, (uint32_t)-1, (uint32_t)-1, (uint32_t)-1, (uint32_t)-1 }, /* Socket 0 Cue 10 */
{ (uint32_t)-1, (uint32_t)-1, (uint32_t)-1, (uint32_t)-1, (uint32_t)-1, (uint32_t)-1 }, /* Socket 0 Cue 11 */
{ (uint32_t)-1, (uint32_t)-1, (uint32_t)-1, (uint32_t)-1, (uint32_t)-1, (uint32_t)-1 }, /* Socket 0 Cue 12 */
{ (uint32_t)-1, (uint32_t)-1, (uint32_t)-1, (uint32_t)-1, (uint32_t)-1, (uint32_t)-1 }, /* Socket 0 Cue 13 */
{ (uint32_t)-1, (uint32_t)-1, (uint32_t)-1, (uint32_t)-1, (uint32_t)-1, (uint32_t)-1 }, /* Socket 0 Cue 14 */
{ (uint32_t)-1, (uint32_t)-1, (uint32_t)-1, (uint32_t)-1, (uint32_t)-1, (uint32_t)-1 }, /* Socket 0 Cue 15 */
{       832787,      1295443, (uint32_t)-1, (uint32_t)-1, (uint32_t)-1, (uint32_t)-1 }, /* Socket 1 Cue 0 */
{       886035,      1075194, (uint32_t)-1, (uint32_t)-1, (uint32_t)-1, (uint32_t)-1 }, /* Socket 1 Cue 1 */
{       398631,       630278, (uint32_t)-1, (uint32_t)-1, (uint32_t)-1, (uint32_t)-1 }, /* Socket 1 Cue 2 */
{      1023889,      1292178, (uint32_t)-1, (uint32_t)-1, (uint32_t)-1, (uint32_t)-1 }, /* Socket 1 Cue 3 */
{       490785,       721209, (uint32_t)-1, (uint32_t)-1, (uint32_t)-1, (uint32_t)-1 }, /* Socket 1 Cue 4 */
{      1372196,       432911, (uint32_t)-1, (uint32_t)-1, (uint32_t)-1, (uint32_t)-1 }, /* Socket 1 Cue 5 */
{      1618102,       262136, (uint32_t)-1, (uint32_t)-1, (uint32_t)-1, (uint32_t)-1 }, /* Socket 1 Cue 6 */
{       542855, (uint32_t)-1, (uint32_t)-1, (uint32_t)-1, (uint32_t)-1, (uint32_t)-1 }, /* Socket 1 Cue 7 */
{ (uint32_t)-1,      1248717, (uint32_t)-1, (uint32_t)-1, (uint32_t)-1, (uint32_t)-1 }, /* Socket 1 Cue 8 */
{ (uint32_t)-1,       550574, (uint32_t)-1, (uint32_t)-1, (uint32_t)-1, (uint32_t)-1 }, /* Socket 1 Cue 9 */
{ (uint32_t)-1,      1327059, (uint32_t)-1, (uint32_t)-1, (uint32_t)-1, (uint32_t)-1 }, /* Socket 1 Cue 10 */
{ (uint32_t)-1,       538855, (uint32_t)-1, (uint32_t)-1, (uint32_t)-1, (uint32_t)-1 }, /* Socket 1 Cue 11 */
{ (uint32_t)-1,      1234034, (uint32_t)-1, (uint32_t)-1, (uint32_t)-1, (uint32_t)-1 }, /* Socket 1 Cue 12 */
{ (uint32_t)-1, (uint32_t)-1, (uint32_t)-1, (uint32_t)-1, (uint32_t)-1, (uint32_t)-1 }, /* Socket 1 Cue 13 */
{ (uint32_t)-1, (uint32_t)-1, (uint32_t)-1, (uint32_t)-1, (uint32_t)-1, (uint32_t)-1 }, /* Socket 1 Cue 14 */
{ (uint32_t)-1, (uint32_t)-1, (uint32_t)-1, (uint32_t)-1, (uint32_t)-1, (uint32_t)-1 }, /* Socket 1 Cue 15 */
{      1124343,      1022841, (uint32_t)-1, (uint32_t)-1, (uint32_t)-1, (uint32_t)-1 }, /* Socket 2 Cue 0 */
{       224754,       490785, (uint32_t)-1, (uint32_t)-1, (uint32_t)-1, (uint32_t)-1 }, /* Socket 2 Cue 1 */
{       283775,      1618102, (uint32_t)-1, (uint32_t)-1, (uint32_t)-1, (uint32_t)-1 }, /* Socket 2 Cue 2 */
{      1186483,       846652, (uint32_t)-1, (uint32_t)-1, (uint32_t)-1, (uint32_t)-1 }, /* Socket 2 Cue 3 */
{       442469,       939527, (uint32_t)-1, (uint32_t)-1, (uint32_t)-1, (uint32_t)-1 }, /* Socket 2 Cue 4 */
{       119786,       768981, (uint32_t)-1, (uint32_t)-1, (uint32_t)-1, (uint32_t)-1 }, /* Socket 2 Cue 5 */
{      1138960,       403091, (uint32_t)-1, (uint32_t)-1, (uint32_t)-1, (uint32_t)-1 }, /* Socket 2 Cue 6 */
{      1364030,       540855, (uint32_t)-1, (uint32_t)-1, (uint32_t)-1, (uint32_t)-1 }, /* Socket 2 Cue 7 */
{       586583, (uint32_t)-1, (uint32_t)-1, (uint32_t)-1, (uint32_t)-1, (uint32_t)-1 }, /* Socket 2 Cue 8 */
{      1265132, (uint32_t)-1, (uint32_t)-1, (uint32_t)-1, (uint32_t)-1, (uint32_t)-1 }, /* Socket 2 Cue 9 */
{      1401718, (uint32_t)-1, (uint32_t)-1, (uint32_t)-1, (uint32_t)-1, (uint32_t)-1 }, /* Socket 2 Cue 10 */
{       544855, (uint32_t)-1, (uint32_t)-1, (uint32_t)-1, (uint32_t)-1, (uint32_t)-1 }, /* Socket 2 Cue 11 */
{ (uint32_t)-1, (uint32_t)-1, (uint32_t)-1, (uint32_t)-1, (uint32_t)-1, (uint32_t)-1 }, /* Socket 2 Cue 12 */
{ (uint32_t)-1, (uint32_t)-1, (uint32_t)-1, (uint32_t)-1, (uint32_t)-1, (uint32_t)-1 }, /* Socket 2 Cue 13 */
{ (uint32_t)-1, (uint32_t)-1, (uint32_t)-1, (uint32_t)-1, (uint32_t)-1, (uint32_t)-1 }, /* Socket 2 Cue 14 */
{ (uint32_t)-1, (uint32_t)-1, (uint32_t)-1, (uint32_t)-1, (uint32_t)-1, (uint32_t)-1 }, /* Socket 2 Cue 15 */
{       964503,       683709, (uint32_t)-1, (uint32_t)-1, (uint32_t)-1, (uint32_t)-1 }, /* Socket 3 Cue 0 */
{          464,       524670, (uint32_t)-1, (uint32_t)-1, (uint32_t)-1, (uint32_t)-1 }, /* Socket 3 Cue 1 */
{      1547084,      1463842, (uint32_t)-1, (uint32_t)-1, (uint32_t)-1, (uint32_t)-1 }, /* Socket 3 Cue 2 */
{        83290,       311249, (uint32_t)-1, (uint32_t)-1, (uint32_t)-1, (uint32_t)-1 }, /* Socket 3 Cue 3 */
{       510631,       915711, (uint32_t)-1, (uint32_t)-1, (uint32_t)-1, (uint32_t)-1 }, /* Socket 3 Cue 4 */
{      1568667, (uint32_t)-1, (uint32_t)-1, (uint32_t)-1, (uint32_t)-1, (uint32_t)-1 }, /* Socket 3 Cue 5 */
{       188841, (uint32_t)-1, (uint32_t)-1, (uint32_t)-1, (uint32_t)-1, (uint32_t)-1 }, /* Socket 3 Cue 6 */
{       910866, (uint32_t)-1, (uint32_t)-1, (uint32_t)-1, (uint32_t)-1, (uint32_t)-1 }, /* Socket 3 Cue 7 */
{       546855, (uint32_t)-1, (uint32_t)-1, (uint32_t)-1, (uint32_t)-1, (uint32_t)-1 }, /* Socket 3 Cue 8 */
{ (uint32_t)-1, (uint32_t)-1, (uint32_t)-1, (uint32_t)-1, (uint32_t)-1, (uint32_t)-1 }, /* Socket 3 Cue 9 */
{ (uint32_t)-1, (uint32_t)-1, (uint32_t)-1, (uint32_t)-1, (uint32_t)-1, (uint32_t)-1 }, /* Socket 3 Cue 10 */
{ (uint32_t)-1, (uint32_t)-1, (uint32_t)-1, (uint32_t)-1, (uint32_t)-1, (uint32_t)-1 }, /* Socket 3 Cue 11 */
{ (uint32_t)-1, (uint32_t)-1, (uint32_t)-1, (uint32_t)-1, (uint32_t)-1, (uint32_t)-1 }, /* Socket 3 Cue 12 */
{ (uint32_t)-1, (uint32_t)-1, (uint32_t)-1, (uint32_t)-1, (uint32_t)-1, (uint32_t)-1 }, /* Socket 3 Cue 13 */
{ (uint32_t)-1, (uint32_t)-1, (uint32_t)-1, (uint32_t)-1, (uint32_t)-1, (uint32_t)-1 }, /* Socket 3 Cue 14 */
{      1642170, (uint32_t)-1, (uint32_t)-1, (uint32_t)-1, (uint32_t)-1, (uint32_t)-1 }, /* Socket 3 Cue 15 */
{       167427,       167427, (uint32_t)-1, (uint32_t)-1, (uint32_t)-1, (uint32_t)-1 }, /* Socket 4 Cue 0 */
{       168871,       168871, (uint32_t)-1, (uint32_t)-1, (uint32_t)-1, (uint32_t)-1 }, /* Socket 4 Cue 1 */
{       171237,       171237, (uint32_t)-1, (uint32_t)-1, (uint32_t)-1, (uint32_t)-1 }, /* Socket 4 Cue 2 */
{      1186384,      1186384, (uint32_t)-1, (uint32_t)-1, (uint32_t)-1, (uint32_t)-1 }, /* Socket 4 Cue 3 */
{      1444808,      1444808, (uint32_t)-1, (uint32_t)-1, (uint32_t)-1, (uint32_t)-1 }, /* Socket 4 Cue 4 */
{      1446177,      1446177, (uint32_t)-1, (uint32_t)-1, (uint32_t)-1, (uint32_t)-1 }, /* Socket 4 Cue 5 */
{      1447315,      1447315, (uint32_t)-1, (uint32_t)-1, (uint32_t)-1, (uint32_t)-1 }, /* Socket 4 Cue 6 */
{      1176084,      1176084, (uint32_t)-1, (uint32_t)-1, (uint32_t)-1, (uint32_t)-1 }, /* Socket 4 Cue 7 */
{            0, (uint32_t)-1, (uint32_t)-1, (uint32_t)-1, (uint32_t)-1, (uint32_t)-1 }, /* Socket 4 Cue 8 */
{ (uint32_t)-1, (uint32_t)-1, (uint32_t)-1, (uint32_t)-1, (uint32_t)-1, (uint32_t)-1 }, /* Socket 4 Cue 9 */
{ (uint32_t)-1, (uint32_t)-1, (uint32_t)-1, (uint32_t)-1, (uint32_t)-1, (uint32_t)-1 }, /* Socket 4 Cue 10 */
{ (uint32_t)-1, (uint32_t)-1, (uint32_t)-1, (uint32_t)-1, (uint32_t)-1, (uint32_t)-1 }, /* Socket 4 Cue 11 */
{ (uint32_t)-1, (uint32_t)-1, (uint32_t)-1, (uint32_t)-1, (uint32_t)-1, (uint32_t)-1 }, /* Socket 4 Cue 12 */
{ (uint32_t)-1, (uint32_t)-1, (uint32_t)-1, (uint32_t)-1, (uint32_t)-1, (uint32_t)-1 }, /* Socket 4 Cue 13 */
{ (uint32_t)-1, (uint32_t)-1, (uint32_t)-1, (uint32_t)-1, (uint32_t)-1, (uint32_t)-1 }, /* Socket 4 Cue 14 */
{ (uint32_t)-1, (uint32_t)-1, (uint32_t)-1, (uint32_t)-1, (uint32_t)-1, (uint32_t)-1 }, /* Socket 4 Cue 15 */
{ (uint32_t)-1, (uint32_t)-1, (uint32_t)-1, (uint32_t)-1, (uint32_t)-1, (uint32_t)-1 }, /* Socket 5 Cue 0 */
{ (uint32_t)-1, (uint32_t)-1, (uint32_t)-1, (uint32_t)-1, (uint32_t)-1, (uint32_t)-1 }, /* Socket 5 Cue 1 */
{ (uint32_t)-1, (uint32_t)-1, (uint32_t)-1, (uint32_t)-1, (uint32_t)-1, (uint32_t)-1 }, /* Socket 5 Cue 2 */
{ (uint32_t)-1, (uint32_t)-1, (uint32_t)-1, (uint32_t)-1, (uint32_t)-1, (uint32_t)-1 }, /* Socket 5 Cue 3 */
{ (uint32_t)-1, (uint32_t)-1, (uint32_t)-1, (uint32_t)-1, (uint32_t)-1, (uint32_t)-1 }, /* Socket 5 Cue 4 */
{ (uint32_t)-1, (uint32_t)-1, (uint32_t)-1, (uint32_t)-1, (uint32_t)-1, (uint32_t)-1 }, /* Socket 5 Cue 5 */
{ (uint32_t)-1, (uint32_t)-1, (uint32_t)-1, (uint32_t)-1, (uint32_t)-1, (uint32_t)-1 }, /* Socket 5 Cue 6 */
{ (uint32_t)-1, (uint32_t)-1, (uint32_t)-1, (uint32_t)-1, (uint32_t)-1, (uint32_t)-1 }, /* Socket 5 Cue 7 */
{ (uint32_t)-1, (uint32_t)-1, (uint32_t)-1, (uint32_t)-1, (uint32_t)-1, (uint32_t)-1 }, /* Socket 5 Cue 8 */
{ (uint32_t)-1, (uint32_t)-1, (uint32_t)-1, (uint32_t)-1, (uint32_t)-1, (uint32_t)-1 }, /* Socket 5 Cue 9 */
{ (uint32_t)-1, (uint32_t)-1, (uint32_t)-1, (uint32_t)-1, (uint32_t)-1, (uint32_t)-1 }, /* Socket 5 Cue 10 */
{ (uint32_t)-1, (uint32_t)-1, (uint32_t)-1, (uint32_t)-1, (uint32_t)-1, (uint32_t)-1 }, /* Socket 5 Cue 11 */
{ (uint32_t)-1, (uint32_t)-1, (uint32_t)-1, (uint32_t)-1, (uint32_t)-1, (uint32_t)-1 }, /* Socket 5 Cue 12 */
{ (uint32_t)-1, (uint32_t)-1, (uint32_t)-1, (uint32_t)-1, (uint32_t)-1, (uint32_t)-1 }, /* Socket 5 Cue 13 */
{ (uint32_t)-1, (uint32_t)-1, (uint32_t)-1, (uint32_t)-1, (uint32_t)-1, (uint32_t)-1 }, /* Socket 5 Cue 14 */
{ (uint32_t)-1, (uint32_t)-1, (uint32_t)-1, (uint32_t)-1, (uint32_t)-1, (uint32_t)-1 }, /* Socket 5 Cue 15 */
{ (uint32_t)-1, (uint32_t)-1, (uint32_t)-1, (uint32_t)-1, (uint32_t)-1, (uint32_t)-1 }, /* Socket 6 Cue 0 */
{ (uint32_t)-1, (uint32_t)-1, (uint32_t)-1, (uint32_t)-1, (uint32_t)-1, (uint32_t)-1 }, /* Socket 6 Cue 1 */
{ (uint32_t)-1, (uint32_t)-1, (uint32_t)-1, (uint32_t)-1, (uint32_t)-1, (uint32_t)-1 }, /* Socket 6 Cue 2 */
{ (uint32_t)-1, (uint32_t)-1, (uint32_t)-1, (uint32_t)-1, (uint32_t)-1, (uint32_t)-1 }, /* Socket 6 Cue 3 */
{ (uint32_t)-1, (uint32_t)-1, (uint32_t)-1, (uint32_t)-1, (uint32_t)-1, (uint32_t)-1 }, /* Socket 6 Cue 4 */
{ (uint32_t)-1, (uint32_t)-1, (uint32_t)-1, (uint32_t)-1, (uint32_t)-1, (uint32_t)-1 }, /* Socket 6 Cue 5 */
{ (uint32_t)-1, (uint32_t)-1, (uint32_t)-1, (uint32_t)-1, (uint32_t)-1, (uint32_t)-1 }, /* Socket 6 Cue 6 */
{ (uint32_t)-1, (uint32_t)-1, (uint32_t)-1, (uint32_t)-1, (uint32_t)-1, (uint32_t)-1 }, /* Socket 6 Cue 7 */
{ (uint32_t)-1, (uint32_t)-1, (uint32_t)-1, (uint32_t)-1, (uint32_t)-1, (uint32_t)-1 }, /* Socket 6 Cue 8 */
{ (uint32_t)-1, (uint32_t)-1, (uint32_t)-1, (uint32_t)-1, (uint32_t)-1, (uint32_t)-1 }, /* Socket 6 Cue 9 */
{ (uint32_t)-1, (uint32_t)-1, (uint32_t)-1, (uint32_t)-1, (uint32_t)-1, (uint32_t)-1 }, /* Socket 6 Cue 10 */
{ (uint32_t)-1, (uint32_t)-1, (uint32_t)-1, (uint32_t)-1, (uint32_t)-1, (uint32_t)-1 }, /* Socket 6 Cue 11 */
{ (uint32_t)-1, (uint32_t)-1, (uint32_t)-1, (uint32_t)-1, (uint32_t)-1, (uint32_t)-1 }, /* Socket 6 Cue 12 */
{ (uint32_t)-1, (uint32_t)-1, (uint32_t)-1, (uint32_t)-1, (uint32_t)-1, (uint32_t)-1 }, /* Socket 6 Cue 13 */
{ (uint32_t)-1, (uint32_t)-1, (uint32_t)-1, (uint32_t)-1, (uint32_t)-1, (uint32_t)-1 }, /* Socket 6 Cue 14 */
{ (uint32_t)-1, (uint32_t)-1, (uint32_t)-1, (uint32_t)-1, (uint32_t)-1, (uint32_t)-1 }, /* Socket 6 Cue 15 */
{ (uint32_t)-1, (uint32_t)-1, (uint32_t)-1, (uint32_t)-1, (uint32_t)-1, (uint32_t)-1 }, /* Socket 7 Cue 0 */
{ (uint32_t)-1, (uint32_t)-1, (uint32_t)-1, (uint32_t)-1, (uint32_t)-1, (uint32_t)-1 }, /* Socket 7 Cue 1 */
{ (uint32_t)-1, (uint32_t)-1, (uint32_t)-1, (uint32_t)-1, (uint32_t)-1, (uint32_t)-1 }, /* Socket 7 Cue 2 */
{ (uint32_t)-1, (uint32_t)-1, (uint32_t)-1, (uint32_t)-1, (uint32_t)-1, (uint32_t)-1 }, /* Socket 7 Cue 3 */
{ (uint32_t)-1, (uint32_t)-1, (uint32_t)-1, (uint32_t)-1, (uint32_t)-1, (uint32_t)-1 }, /* Socket 7 Cue 4 */
{ (uint32_t)-1, (uint32_t)-1, (uint32_t)-1, (uint32_t)-1, (uint32_t)-1, (uint32_t)-1 }, /* Socket 7 Cue 5 */
{ (uint32_t)-1, (uint32_t)-1, (uint32_t)-1, (uint32_t)-1, (uint32_t)-1, (uint32_t)-1 }, /* Socket 7 Cue 6 */
{ (uint32_t)-1, (uint32_t)-1, (uint32_t)-1, (uint32_t)-1, (uint32_t)-1, (uint32_t)-1 }, /* Socket 7 Cue 7 */
{ (uint32_t)-1, (uint32_t)-1, (uint32_t)-1, (uint32_t)-1, (uint32_t)-1, (uint32_t)-1 }, /* Socket 7 Cue 8 */
{ (uint32_t)-1, (uint32_t)-1, (uint32_t)-1, (uint32_t)-1, (uint32_t)-1, (uint32_t)-1 }, /* Socket 7 Cue 9 */
{ (uint32_t)-1, (uint32_t)-1, (uint32_t)-1, (uint32_t)-1, (uint32_t)-1, (uint32_t)-1 }, /* Socket 7 Cue 10 */
{ (uint32_t)-1, (uint32_t)-1, (uint32_t)-1, (uint32_t)-1, (uint32_t)-1, (uint32_t)-1 }, /* Socket 7 Cue 11 */
{ (uint32_t)-1, (uint32_t)-1, (uint32_t)-1, (uint32_t)-1, (uint32_t)-1, (uint32_t)-1 }, /* Socket 7 Cue 12 */
{ (uint32_t)-1, (uint32_t)-1, (uint32_t)-1, (uint32_t)-1, (uint32_t)-1, (uint32_t)-1 }, /* Socket 7 Cue 13 */
{ (uint32_t)-1, (uint32_t)-1, (uint32_t)-1, (uint32_t)-1, (uint32_t)-1, (uint32_t)-1 }, /* Socket 7 Cue 14 */
{ (uint32_t)-1, (uint32_t)-1, (uint32_t)-1, (uint32_t)-1, (uint32_t)-1, (uint32_t)-1 } /* Socket 7 Cue 15 */

/*
Expected scan response:
Remote-0 scan response:
Socket 0: Q00 Q01 Q02 Q03 Q04
Socket 1: Q00 Q01 Q02 Q03 Q04 Q05 Q06 Q07
Socket 2: Q00 Q01 Q02 Q03 Q04 Q05 Q06 Q07 Q08 Q09 Q10 Q11
Socket 3: Q00 Q01 Q02 Q03 Q04 Q05 Q06 Q07 Q08                         Q15
Socket 4: Q00 Q01 Q02 Q03 Q04 Q05 Q06 Q07 Q08
Socket 5:
Socket 6:
Socket 7:
Remote-1 scan response:
Socket 0: Q00 Q01 Q02 Q03 Q04 Q05 Q06 Q07 Q08
Socket 1: Q00 Q01 Q02 Q03 Q04 Q05 Q06     Q08 Q09 Q10 Q11 Q12
Socket 2: Q00 Q01 Q02 Q03 Q04 Q05 Q06 Q07
Socket 3: Q00 Q01 Q02 Q03 Q04
Socket 4: Q00 Q01 Q02 Q03 Q04 Q05 Q06 Q07
Socket 5:
Socket 6:
Socket 7:
Remote-2 scan response:
Socket 0:
Socket 1:
Socket 2:
Socket 3:
Socket 4:
Socket 5:
Socket 6:
Socket 7:
Remote-3 scan response:
Socket 0:
Socket 1:
Socket 2:
Socket 3:
Socket 4:
Socket 5:
Socket 6:
Socket 7:
Remote-4 scan response:
Socket 0:
Socket 1:
Socket 2:
Socket 3:
Socket 4:
Socket 5:
Socket 6:
Socket 7:
Remote-5 scan response:
Socket 0:
Socket 1:
Socket 2:
Socket 3:
Socket 4:
Socket 5:
Socket 6:
Socket 7:
*/