/*  Module 0  ,   Module 1  ,   Module 2  ,   Module 3  ,   Module 4  ,   Module 5   */
{      1947982,      1490498,      2341351,      1023326, (uint32_t)-1, (uint32_t)-1 }, /* Socket 0 Cue 0 */
{      2423026,       451311,      1571833,      1685231, (uint32_t)-1, (uint32_t)-1 }, /* Socket 0 Cue 1 */
{       125872,      2575005,      2032139,      1692565, (uint32_t)-1, (uint32_t)-1 }, /* Socket 0 Cue 2 */
{      1004174,       470482,      2239416,      1695009, (uint32_t)-1, (uint32_t)-1 }, /* Socket 0 Cue 3 */
{      2062751,       209851,       194200,      1697454, (uint32_t)-1, (uint32_t)-1 }, /* Socket 0 Cue 4 */
{      1076623,       899234,       714339,      1699898, (uint32_t)-1, (uint32_t)-1 }, /* Socket 0 Cue 5 */
{      2621560,      2061780,      1826756,      1054315, (uint32_t)-1, (uint32_t)-1 }, /* Socket 0 Cue 6 */
{       569623,      2448389,      2553381,      1042440, (uint32_t)-1, (uint32_t)-1 }, /* Socket 0 Cue 7 */
{      1819111,      1440985,       614428,      2694518, (uint32_t)-1, (uint32_t)-1 }, /* Socket 0 Cue 8 */
{      1714950,       505530,      2596707,      1035315, (uint32_t)-1, (uint32_t)-1 }, /* Socket 0 Cue 9 */
{      1822902,      1822823,      1913458,      1051940, (uint32_t)-1, (uint32_t)-1 }, /* Socket 0 Cue 10 */
{      2116370,       589526,      2702131,      1047190, (uint32_t)-1, (uint32_t)-1 }, /* Socket 0 Cue 11 */
{ (uint32_t)-1, (uint32_t)-1, (uint32_t)-1,      1056690, (uint32_t)-1, (uint32_t)-1 }, /* Socket 0 Cue 12 */
{ (uint32_t)-1, (uint32_t)-1, (uint32_t)-1,      1061440, (uint32_t)-1, (uint32_t)-1 }, /* Socket 0 Cue 13 */
{ (uint32_t)-1, (uint32_t)-1, (uint32_t)-1,      1063815, (uint32_t)-1, (uint32_t)-1 }, /* Socket 0 Cue 14 */
{ (uint32_t)-1, (uint32_t)-1, (uint32_t)-1,      1851019, (uint32_t)-1, (uint32_t)-1 }, /* Socket 0 Cue 15 */
{      1215501,      2672381,       971559,      1853019, (uint32_t)-1, (uint32_t)-1 }, /* Socket 1 Cue 0 */
{       193057,      2672601,      2033639,      1773753, (uint32_t)-1, (uint32_t)-1 }, /* Socket 1 Cue 1 */
{       377330,      1154514,      2387121,      1775753, (uint32_t)-1, (uint32_t)-1 }, /* Socket 1 Cue 2 */
{       338716,      2262154,      1095328,      1777494, (uint32_t)-1, (uint32_t)-1 }, /* Socket 1 Cue 3 */
{      2026271,       698628,      2397969,      1779494, (uint32_t)-1, (uint32_t)-1 }, /* Socket 1 Cue 4 */
{      2406059,      2552862,       194486,      1704058, (uint32_t)-1, (uint32_t)-1 }, /* Socket 1 Cue 5 */
{       657029,      2621560,      1979508,      1706058, (uint32_t)-1, (uint32_t)-1 }, /* Socket 1 Cue 6 */
{ (uint32_t)-1,      1130775,      1276232,      1708284, (uint32_t)-1, (uint32_t)-1 }, /* Socket 1 Cue 7 */
{ (uint32_t)-1,       193915,      1515309,      1710284, (uint32_t)-1, (uint32_t)-1 }, /* Socket 1 Cue 8 */
{ (uint32_t)-1,      2029139,      2064389,      1701791, (uint32_t)-1, (uint32_t)-1 }, /* Socket 1 Cue 9 */
{ (uint32_t)-1,       433534,       751276,      1592158, (uint32_t)-1, (uint32_t)-1 }, /* Socket 1 Cue 10 */
{ (uint32_t)-1,      1076623, (uint32_t)-1,      1601534, (uint32_t)-1, (uint32_t)-1 }, /* Socket 1 Cue 11 */
{ (uint32_t)-1,      2236198, (uint32_t)-1,      1606222, (uint32_t)-1, (uint32_t)-1 }, /* Socket 1 Cue 12 */
{ (uint32_t)-1,      2274477, (uint32_t)-1,      1610909, (uint32_t)-1, (uint32_t)-1 }, /* Socket 1 Cue 13 */
{ (uint32_t)-1, (uint32_t)-1, (uint32_t)-1,      1620285, (uint32_t)-1, (uint32_t)-1 }, /* Socket 1 Cue 14 */
{ (uint32_t)-1, (uint32_t)-1, (uint32_t)-1,      1615597, (uint32_t)-1, (uint32_t)-1 }, /* Socket 1 Cue 15 */
{      2341351,      2573795,      2648732, (uint32_t)-1, (uint32_t)-1, (uint32_t)-1 }, /* Socket 2 Cue 0 */
{      2081433,      2230341,      2599362, (uint32_t)-1, (uint32_t)-1, (uint32_t)-1 }, /* Socket 2 Cue 1 */
{      1627712,      2042798,      2136352, (uint32_t)-1, (uint32_t)-1, (uint32_t)-1 }, /* Socket 2 Cue 2 */
{       177572,      1182718,        49209, (uint32_t)-1, (uint32_t)-1, (uint32_t)-1 }, /* Socket 2 Cue 3 */
{      2065583,       192772,      2026139, (uint32_t)-1, (uint32_t)-1, (uint32_t)-1 }, /* Socket 2 Cue 4 */
{       229169,      2101581,       629241, (uint32_t)-1, (uint32_t)-1, (uint32_t)-1 }, /* Socket 2 Cue 5 */
{       639255,       302068,       735839, (uint32_t)-1, (uint32_t)-1, (uint32_t)-1 }, /* Socket 2 Cue 6 */
{      1750917,       851651,      1199398, (uint32_t)-1, (uint32_t)-1, (uint32_t)-1 }, /* Socket 2 Cue 7 */
{       193629,       926872,      2081433, (uint32_t)-1, (uint32_t)-1, (uint32_t)-1 }, /* Socket 2 Cue 8 */
{ (uint32_t)-1,      1715315,       193343, (uint32_t)-1, (uint32_t)-1, (uint32_t)-1 }, /* Socket 2 Cue 9 */
{ (uint32_t)-1,      2202634,      1230474, (uint32_t)-1, (uint32_t)-1, (uint32_t)-1 }, /* Socket 2 Cue 10 */
{ (uint32_t)-1,      2213403, (uint32_t)-1, (uint32_t)-1, (uint32_t)-1, (uint32_t)-1 }, /* Socket 2 Cue 11 */
{ (uint32_t)-1,       214775, (uint32_t)-1, (uint32_t)-1, (uint32_t)-1, (uint32_t)-1 }, /* Socket 2 Cue 12 */
{ (uint32_t)-1,      1340694, (uint32_t)-1, (uint32_t)-1, (uint32_t)-1, (uint32_t)-1 }, /* Socket 2 Cue 13 */
{ (uint32_t)-1,      2041006, (uint32_t)-1, (uint32_t)-1, (uint32_t)-1, (uint32_t)-1 }, /* Socket 2 Cue 14 */
{ (uint32_t)-1, (uint32_t)-1, (uint32_t)-1, (uint32_t)-1, (uint32_t)-1, (uint32_t)-1 }, /* Socket 2 Cue 15 */
{      1809797,      1368918,      2672381, (uint32_t)-1, (uint32_t)-1, (uint32_t)-1 }, /* Socket 3 Cue 0 */
{      1400518,      2648732,       417313, (uint32_t)-1, (uint32_t)-1, (uint32_t)-1 }, /* Socket 3 Cue 1 */
{      1344443,       803334,      2577256, (uint32_t)-1, (uint32_t)-1, (uint32_t)-1 }, /* Socket 3 Cue 2 */
{       798334,      2601814,      2155634, (uint32_t)-1, (uint32_t)-1, (uint32_t)-1 }, /* Socket 3 Cue 3 */
{      2101581,       317936,       192486, (uint32_t)-1, (uint32_t)-1, (uint32_t)-1 }, /* Socket 3 Cue 4 */
{      1826756,      2030639,      1076623, (uint32_t)-1, (uint32_t)-1, (uint32_t)-1 }, /* Socket 3 Cue 5 */
{      2388156,       361654,       775625, (uint32_t)-1, (uint32_t)-1, (uint32_t)-1 }, /* Socket 3 Cue 6 */
{      2117290,        85938,      2596707, (uint32_t)-1, (uint32_t)-1, (uint32_t)-1 }, /* Socket 3 Cue 7 */
{      1288885,      2483753,      1714950, (uint32_t)-1, (uint32_t)-1, (uint32_t)-1 }, /* Socket 3 Cue 8 */
{      1538578,      1784727,      1822902, (uint32_t)-1, (uint32_t)-1, (uint32_t)-1 }, /* Socket 3 Cue 9 */
{      2700095,       494272,      2116370, (uint32_t)-1, (uint32_t)-1, (uint32_t)-1 }, /* Socket 3 Cue 10 */
{ (uint32_t)-1,      1750557, (uint32_t)-1, (uint32_t)-1, (uint32_t)-1, (uint32_t)-1 }, /* Socket 3 Cue 11 */
{ (uint32_t)-1,      2078983, (uint32_t)-1, (uint32_t)-1, (uint32_t)-1, (uint32_t)-1 }, /* Socket 3 Cue 12 */
{ (uint32_t)-1, (uint32_t)-1, (uint32_t)-1, (uint32_t)-1, (uint32_t)-1, (uint32_t)-1 }, /* Socket 3 Cue 13 */
{ (uint32_t)-1, (uint32_t)-1, (uint32_t)-1, (uint32_t)-1, (uint32_t)-1, (uint32_t)-1 }, /* Socket 3 Cue 14 */
{ (uint32_t)-1, (uint32_t)-1, (uint32_t)-1, (uint32_t)-1, (uint32_t)-1, (uint32_t)-1 }, /* Socket 3 Cue 15 */
{          898,            0,         9768, (uint32_t)-1, (uint32_t)-1, (uint32_t)-1 }, /* Socket 4 Cue 0 */
{         5333,         3116,        11985, (uint32_t)-1, (uint32_t)-1, (uint32_t)-1 }, /* Socket 4 Cue 1 */
{         7551,        14203,        16420, (uint32_t)-1, (uint32_t)-1, (uint32_t)-1 }, /* Socket 4 Cue 2 */
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{      2696893,      1594502, (uint32_t)-1, (uint32_t)-1, (uint32_t)-1, (uint32_t)-1 } /* Socket 7 Cue 15 */
