/*  Module 0  ,   Module 1  ,   Module 2  ,   Module 3  ,   Module 4  ,   Module 5   */
{      1702494,      2007322, (uint32_t)-1,      1534154,      1536450, (uint32_t)-1 }, /* Socket 0 Cue 0 */
{      1815528,      2013098,      2013098,      1537602,      1540721, (uint32_t)-1 }, /* Socket 0 Cue 1 */
{      2166424,      2165259,      2164997,      1541721,      1542721, (uint32_t)-1 }, /* Socket 0 Cue 2 */
{      1742324,      2011181,      2011181,      1544499,      1547947, (uint32_t)-1 }, /* Socket 0 Cue 3 */
{      1960289,      2165259,      2165259,      1551395,      1554843, (uint32_t)-1 }, /* Socket 0 Cue 4 */
{      1702267,      2007322,      2009239,      1556466,      1558292, (uint32_t)-1 }, /* Socket 0 Cue 5 */
{      1786290,      1702949,      1787040,      1561740,      1564764, (uint32_t)-1 }, /* Socket 0 Cue 6 */
{      1916141,      1921906,      1704312,      1564997,      1566790, (uint32_t)-1 }, /* Socket 0 Cue 7 */
{      2007322,      1782596,      1958876,      1570123,      1573457, (uint32_t)-1 }, /* Socket 0 Cue 8 */
{      2011181,      1703176,      2013098,      1576790,      1579137, (uint32_t)-1 }, /* Socket 0 Cue 9 */
{      2009239, (uint32_t)-1,      2016750,      1571610,      1568814, (uint32_t)-1 }, /* Socket 0 Cue 10 */
{      2009239,      2217234,      2019550,      1580123,      1582650, (uint32_t)-1 }, /* Socket 0 Cue 11 */
{      2165259,      1636522,      1957107,      1585284,       917393, (uint32_t)-1 }, /* Socket 0 Cue 12 */
{      2164667, (uint32_t)-1,      1652022,       918285,       920285, (uint32_t)-1 }, /* Socket 0 Cue 13 */
{      1966989, (uint32_t)-1,      2463071,       922285,       934787, (uint32_t)-1 }, /* Socket 0 Cue 14 */
{ (uint32_t)-1, (uint32_t)-1,      1966989,       939436,       944085, (uint32_t)-1 }, /* Socket 0 Cue 15 */
{      2007322,      2148724,      1704540,       948734,       953383, (uint32_t)-1 }, /* Socket 1 Cue 0 */
{      2165259,      1783758,      1916641,       958033,       962682, (uint32_t)-1 }, /* Socket 1 Cue 1 */
{      2011181,      1703403,      2166424,       967331,       971980, (uint32_t)-1 }, /* Socket 1 Cue 2 */
{      2165259,      2066663,      1733697,       976629,       981278, (uint32_t)-1 }, /* Socket 1 Cue 3 */
{      2009249,      2007322,      1815528,       985927,       990576, (uint32_t)-1 }, /* Socket 1 Cue 4 */
{      2007322,      2013098,      1783508,       995226,       999875, (uint32_t)-1 }, /* Socket 1 Cue 5 */
{      1786540,      2011181,      1704767,      1004524,      1009173, (uint32_t)-1 }, /* Socket 1 Cue 6 */
{      1702722,      2009239,      2007322,      1013822,      1018471, (uint32_t)-1 }, /* Socket 1 Cue 7 */
{      1953669,      2165259,      2013098,      1023120,      1027769, (uint32_t)-1 }, /* Socket 1 Cue 8 */
{      2013098,      2163730,      2011181,      1032419,      1037068, (uint32_t)-1 }, /* Socket 1 Cue 9 */
{      2020950,      1948669,      2009239,      1041717,      1046366, (uint32_t)-1 }, /* Socket 1 Cue 10 */
{      2018150,      1955394,      2165259,      1051015,      1055664, (uint32_t)-1 }, /* Socket 1 Cue 11 */
{      1653529,      1915251,      2165259,      1060313,      1064962, (uint32_t)-1 }, /* Socket 1 Cue 12 */
{      2464367, (uint32_t)-1,      2183565,      1069612,      1074261, (uint32_t)-1 }, /* Socket 1 Cue 13 */
{      1964634, (uint32_t)-1, (uint32_t)-1,      1078910,      1083559, (uint32_t)-1 }, /* Socket 1 Cue 14 */
{ (uint32_t)-1, (uint32_t)-1, (uint32_t)-1,      1088208,      1092857, (uint32_t)-1 }, /* Socket 1 Cue 15 */
{      2188287,      2086386,      1879303,      1097506,      1102155, (uint32_t)-1 }, /* Socket 2 Cue 0 */
{      2194997,      1703631,      1882989,      1106805,      1111454, (uint32_t)-1 }, /* Socket 2 Cue 1 */
{      2191384,      1779687,      1883809,      1116103,      1120752, (uint32_t)-1 }, /* Socket 2 Cue 2 */
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{      1912483,      1912893,      2190351, (uint32_t)-1,      1404396, (uint32_t)-1 }, /* Socket 5 Cue 11 */
{ (uint32_t)-1, (uint32_t)-1,      2196545, (uint32_t)-1,       866984, (uint32_t)-1 }, /* Socket 5 Cue 12 */
{ (uint32_t)-1, (uint32_t)-1,      2207868, (uint32_t)-1,      2468226, (uint32_t)-1 }, /* Socket 5 Cue 13 */
{ (uint32_t)-1, (uint32_t)-1,      2202706, (uint32_t)-1, (uint32_t)-1, (uint32_t)-1 }, /* Socket 5 Cue 14 */
{ (uint32_t)-1, (uint32_t)-1,      2185190, (uint32_t)-1, (uint32_t)-1, (uint32_t)-1 }, /* Socket 5 Cue 15 */
{ (uint32_t)-1, (uint32_t)-1, (uint32_t)-1, (uint32_t)-1, (uint32_t)-1, (uint32_t)-1 }, /* Socket 6 Cue 0 */
{ (uint32_t)-1, (uint32_t)-1, (uint32_t)-1, (uint32_t)-1, (uint32_t)-1, (uint32_t)-1 }, /* Socket 6 Cue 1 */
{ (uint32_t)-1, (uint32_t)-1, (uint32_t)-1, (uint32_t)-1, (uint32_t)-1, (uint32_t)-1 }, /* Socket 6 Cue 2 */
{ (uint32_t)-1, (uint32_t)-1, (uint32_t)-1, (uint32_t)-1, (uint32_t)-1, (uint32_t)-1 }, /* Socket 6 Cue 3 */
{ (uint32_t)-1, (uint32_t)-1, (uint32_t)-1, (uint32_t)-1, (uint32_t)-1, (uint32_t)-1 }, /* Socket 6 Cue 4 */
{ (uint32_t)-1, (uint32_t)-1, (uint32_t)-1, (uint32_t)-1, (uint32_t)-1, (uint32_t)-1 }, /* Socket 6 Cue 5 */
{ (uint32_t)-1, (uint32_t)-1, (uint32_t)-1, (uint32_t)-1, (uint32_t)-1, (uint32_t)-1 }, /* Socket 6 Cue 6 */
{ (uint32_t)-1, (uint32_t)-1, (uint32_t)-1, (uint32_t)-1, (uint32_t)-1, (uint32_t)-1 }, /* Socket 6 Cue 7 */
{ (uint32_t)-1, (uint32_t)-1, (uint32_t)-1, (uint32_t)-1, (uint32_t)-1, (uint32_t)-1 }, /* Socket 6 Cue 8 */
{ (uint32_t)-1, (uint32_t)-1, (uint32_t)-1, (uint32_t)-1, (uint32_t)-1, (uint32_t)-1 }, /* Socket 6 Cue 9 */
{ (uint32_t)-1, (uint32_t)-1, (uint32_t)-1, (uint32_t)-1, (uint32_t)-1, (uint32_t)-1 }, /* Socket 6 Cue 10 */
{ (uint32_t)-1, (uint32_t)-1, (uint32_t)-1, (uint32_t)-1, (uint32_t)-1, (uint32_t)-1 }, /* Socket 6 Cue 11 */
{ (uint32_t)-1, (uint32_t)-1, (uint32_t)-1, (uint32_t)-1, (uint32_t)-1, (uint32_t)-1 }, /* Socket 6 Cue 12 */
{ (uint32_t)-1, (uint32_t)-1, (uint32_t)-1, (uint32_t)-1, (uint32_t)-1, (uint32_t)-1 }, /* Socket 6 Cue 13 */
{ (uint32_t)-1, (uint32_t)-1, (uint32_t)-1, (uint32_t)-1, (uint32_t)-1, (uint32_t)-1 }, /* Socket 6 Cue 14 */
{ (uint32_t)-1, (uint32_t)-1, (uint32_t)-1, (uint32_t)-1, (uint32_t)-1, (uint32_t)-1 }, /* Socket 6 Cue 15 */
{ (uint32_t)-1, (uint32_t)-1, (uint32_t)-1, (uint32_t)-1, (uint32_t)-1, (uint32_t)-1 }, /* Socket 7 Cue 0 */
{ (uint32_t)-1, (uint32_t)-1, (uint32_t)-1, (uint32_t)-1, (uint32_t)-1, (uint32_t)-1 }, /* Socket 7 Cue 1 */
{ (uint32_t)-1, (uint32_t)-1, (uint32_t)-1, (uint32_t)-1, (uint32_t)-1, (uint32_t)-1 }, /* Socket 7 Cue 2 */
{ (uint32_t)-1, (uint32_t)-1, (uint32_t)-1, (uint32_t)-1, (uint32_t)-1, (uint32_t)-1 }, /* Socket 7 Cue 3 */
{ (uint32_t)-1, (uint32_t)-1, (uint32_t)-1, (uint32_t)-1, (uint32_t)-1, (uint32_t)-1 }, /* Socket 7 Cue 4 */
{ (uint32_t)-1, (uint32_t)-1, (uint32_t)-1, (uint32_t)-1, (uint32_t)-1, (uint32_t)-1 }, /* Socket 7 Cue 5 */
{ (uint32_t)-1, (uint32_t)-1, (uint32_t)-1, (uint32_t)-1, (uint32_t)-1, (uint32_t)-1 }, /* Socket 7 Cue 6 */
{ (uint32_t)-1, (uint32_t)-1, (uint32_t)-1, (uint32_t)-1, (uint32_t)-1, (uint32_t)-1 }, /* Socket 7 Cue 7 */
{ (uint32_t)-1, (uint32_t)-1, (uint32_t)-1, (uint32_t)-1, (uint32_t)-1, (uint32_t)-1 }, /* Socket 7 Cue 8 */
{ (uint32_t)-1, (uint32_t)-1, (uint32_t)-1, (uint32_t)-1, (uint32_t)-1, (uint32_t)-1 }, /* Socket 7 Cue 9 */
{ (uint32_t)-1, (uint32_t)-1, (uint32_t)-1, (uint32_t)-1, (uint32_t)-1, (uint32_t)-1 }, /* Socket 7 Cue 10 */
{ (uint32_t)-1, (uint32_t)-1, (uint32_t)-1, (uint32_t)-1, (uint32_t)-1, (uint32_t)-1 }, /* Socket 7 Cue 11 */
{ (uint32_t)-1, (uint32_t)-1, (uint32_t)-1, (uint32_t)-1, (uint32_t)-1, (uint32_t)-1 }, /* Socket 7 Cue 12 */
{ (uint32_t)-1, (uint32_t)-1, (uint32_t)-1, (uint32_t)-1, (uint32_t)-1, (uint32_t)-1 }, /* Socket 7 Cue 13 */
{ (uint32_t)-1, (uint32_t)-1, (uint32_t)-1, (uint32_t)-1, (uint32_t)-1, (uint32_t)-1 }, /* Socket 7 Cue 14 */
{ (uint32_t)-1, (uint32_t)-1, (uint32_t)-1, (uint32_t)-1, (uint32_t)-1, (uint32_t)-1 } /* Socket 7 Cue 15 */

/*
2 duplicate cues with different firing times.
0 cues found with missing firing data.
415 cues added to program.


Expected scan response:
Remote-0 scan response:
Socket 0: Q00 Q01 Q02 Q03 Q04 Q05 Q06 Q07 Q08 Q09 Q10 Q11 Q12 Q13 Q14
Socket 1: Q00 Q01 Q02 Q03 Q04 Q05 Q06 Q07 Q08 Q09 Q10 Q11 Q12 Q13 Q14
Socket 2: Q00 Q01 Q02 Q03 Q04 Q05 Q06 Q07 Q08 Q09 Q10 Q11 Q12 Q13 Q14 Q15
Socket 3: Q00 Q01 Q02 Q03 Q04 Q05 Q06 Q07 Q08 Q09 Q10 Q11 Q12 Q13 Q14 Q15
Socket 4: Q00 Q01 Q02 Q03 Q04 Q05 Q06 Q07 Q08 Q09 Q10 Q11 Q12 Q13 Q14 Q15
Socket 5: Q00 Q01 Q02 Q03 Q04 Q05 Q06 Q07 Q08 Q09 Q10 Q11
Socket 6:
Socket 7:
Remote-1 scan response:
Socket 0: Q00 Q01 Q02 Q03 Q04 Q05 Q06 Q07 Q08 Q09     Q11 Q12
Socket 1: Q00 Q01 Q02 Q03 Q04 Q05 Q06 Q07 Q08 Q09 Q10 Q11 Q12
Socket 2: Q00 Q01 Q02 Q03 Q04 Q05 Q06 Q07 Q08 Q09 Q10 Q11
Socket 3:     Q01 Q02 Q03 Q04 Q05 Q06 Q07 Q08 Q09 Q10 Q11 Q12
Socket 4: Q00 Q01 Q02 Q03 Q04 Q05 Q06 Q07 Q08 Q09 Q10 Q11 Q12 Q13 Q14 Q15
Socket 5: Q00 Q01 Q02 Q03 Q04 Q05 Q06 Q07 Q08 Q09 Q10 Q11
Socket 6:
Socket 7:
Remote-2 scan response:
Socket 0:     Q01 Q02 Q03 Q04 Q05 Q06 Q07 Q08 Q09 Q10 Q11 Q12 Q13 Q14 Q15
Socket 1: Q00 Q01 Q02 Q03 Q04 Q05 Q06 Q07 Q08 Q09 Q10 Q11 Q12 Q13
Socket 2: Q00 Q01 Q02 Q03 Q04 Q05 Q06 Q07 Q08 Q09 Q10 Q11 Q12 Q13 Q14 Q15
Socket 3: Q00 Q01 Q02 Q03 Q04 Q05 Q06 Q07 Q08 Q09 Q10 Q11 Q12
Socket 4: Q00 Q01 Q02 Q03 Q04 Q05 Q06 Q07 Q08 Q09 Q10 Q11 Q12 Q13 Q14 Q15
Socket 5: Q00 Q01 Q02 Q03 Q04 Q05 Q06 Q07 Q08 Q09 Q10 Q11 Q12 Q13 Q14 Q15
Socket 6:
Socket 7:
Remote-3 scan response:
Socket 0: Q00 Q01 Q02 Q03 Q04 Q05 Q06 Q07 Q08 Q09 Q10 Q11 Q12 Q13 Q14 Q15
Socket 1: Q00 Q01 Q02 Q03 Q04 Q05 Q06 Q07 Q08 Q09 Q10 Q11 Q12 Q13 Q14 Q15
Socket 2: Q00 Q01 Q02 Q03 Q04 Q05 Q06 Q07 Q08 Q09 Q10 Q11 Q12 Q13
Socket 3: Q00 Q01 Q02     Q04 Q05 Q06 Q07 Q08 Q09 Q10 Q11
Socket 4: Q00 Q01 Q02 Q03 Q04 Q05 Q06 Q07 Q08 Q09 Q10
Socket 5: Q00 Q01 Q02 Q03 Q04 Q05 Q06 Q07 Q08 Q09 Q10
Socket 6:
Socket 7:
Remote-4 scan response:
Socket 0: Q00 Q01 Q02 Q03 Q04 Q05 Q06 Q07 Q08 Q09 Q10 Q11 Q12 Q13 Q14 Q15
Socket 1: Q00 Q01 Q02 Q03 Q04 Q05 Q06 Q07 Q08 Q09 Q10 Q11 Q12 Q13 Q14 Q15
Socket 2: Q00 Q01 Q02 Q03 Q04 Q05 Q06 Q07 Q08 Q09 Q10 Q11 Q12
Socket 3: Q00     Q02 Q03 Q04 Q05 Q06 Q07 Q08 Q09 Q10 Q11
Socket 4: Q00 Q01 Q02 Q03 Q04 Q05 Q06 Q07 Q08 Q09
Socket 5: Q00 Q01 Q02 Q03 Q04 Q05 Q06     Q08 Q09 Q10 Q11 Q12 Q13
Socket 6:
Socket 7:
Remote-5 scan response:
Socket 0:
Socket 1:
Socket 2:
Socket 3:
Socket 4:
Socket 5:
Socket 6:
Socket 7:
*/