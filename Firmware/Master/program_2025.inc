/*  Module 0  ,   Module 1  ,   Module 2  ,   Module 3  ,   Module 4  ,   Module 5   */
{      2128718,      1764061,      1897547,       995336,       595984, (uint32_t)-1 }, /* Socket 0 Cue 0 */
{      2942993,      1739695,      2356638,      1005086,       598589, (uint32_t)-1 }, /* Socket 0 Cue 1 */
{      2532179,      2287698,       441721,      1014836,       591406, (uint32_t)-1 }, /* Socket 0 Cue 2 */
{       243980,      2475864,      2539285,      1018086,       627102, (uint32_t)-1 }, /* Socket 0 Cue 3 */
{       469692,       658582,       469692,      1021336,       631680, (uint32_t)-1 }, /* Socket 0 Cue 4 */
{      2509144,      2828737,      1068270,      1054087,       634285, (uint32_t)-1 }, /* Socket 0 Cue 5 */
{      2325218,       144243,      1717279,      1063837,       675793, (uint32_t)-1 }, /* Socket 0 Cue 6 */
{       547398,       469692,        39093,      1088737,       688338, (uint32_t)-1 }, /* Socket 0 Cue 7 */
{      2892228,       135760,       504177,      1091987,       707926, (uint32_t)-1 }, /* Socket 0 Cue 8 */
{      2940825,        56326,      2641412,      1098487,       710103, (uint32_t)-1 }, /* Socket 0 Cue 9 */
{ (uint32_t)-1, (uint32_t)-1,       332866,      1101737,       712279, (uint32_t)-1 }, /* Socket 0 Cue 10 */
{ (uint32_t)-1, (uint32_t)-1, (uint32_t)-1,      1108237,       714456, (uint32_t)-1 }, /* Socket 0 Cue 11 */
{ (uint32_t)-1, (uint32_t)-1, (uint32_t)-1,      1114737,       720985, (uint32_t)-1 }, /* Socket 0 Cue 12 */
{ (uint32_t)-1, (uint32_t)-1, (uint32_t)-1,      1117987,      2112634, (uint32_t)-1 }, /* Socket 0 Cue 13 */
{ (uint32_t)-1, (uint32_t)-1, (uint32_t)-1,      1121237,      2119634, (uint32_t)-1 }, /* Socket 0 Cue 14 */
{ (uint32_t)-1, (uint32_t)-1, (uint32_t)-1,      1134237,      2121968, (uint32_t)-1 }, /* Socket 0 Cue 15 */
{      1203179,       975093,      1485274,      1140737,      2171905, (uint32_t)-1 }, /* Socket 1 Cue 0 */
{      2398239,       912512,       664582,       264012,      2181016, (uint32_t)-1 }, /* Socket 1 Cue 1 */
{      2785448,       504177,        79755,       265120,      2199238, (uint32_t)-1 }, /* Socket 1 Cue 2 */
{       652582,       660582,      1792246,       494660,      2202275, (uint32_t)-1 }, /* Socket 1 Cue 3 */
{       504177,      1685680,       504177,       496733,      2205312, (uint32_t)-1 }, /* Socket 1 Cue 4 */
{         1024,       602268,        85689,       498740,      2208349, (uint32_t)-1 }, /* Socket 1 Cue 5 */
{      2081255,      1783881,      1448180,       481674,      2211386, (uint32_t)-1 }, /* Socket 1 Cue 6 */
{      2721456,      1644980,      1975496,       483948,      2214423, (uint32_t)-1 }, /* Socket 1 Cue 7 */
{       871498,       113351,      1323444,       486490,      2217460, (uint32_t)-1 }, /* Socket 1 Cue 8 */
{      1669801,       650446, (uint32_t)-1,       489634,      2220497, (uint32_t)-1 }, /* Socket 1 Cue 9 */
{      1834798,      2969467, (uint32_t)-1,       491641,      2226571, (uint32_t)-1 }, /* Socket 1 Cue 10 */
{       500759,      2710994, (uint32_t)-1,       512977,      2232645, (uint32_t)-1 }, /* Socket 1 Cue 11 */
{ (uint32_t)-1,      1614236, (uint32_t)-1,       516188,      2235682, (uint32_t)-1 }, /* Socket 1 Cue 12 */
{ (uint32_t)-1, (uint32_t)-1, (uint32_t)-1,       117809,      2238719, (uint32_t)-1 }, /* Socket 1 Cue 13 */
{ (uint32_t)-1, (uint32_t)-1, (uint32_t)-1,       510169,      2244793, (uint32_t)-1 }, /* Socket 1 Cue 14 */
{ (uint32_t)-1, (uint32_t)-1, (uint32_t)-1,       523881,      2247830, (uint32_t)-1 }, /* Socket 1 Cue 15 */
{       469692,       745252,      1514998,       683985,      2250867, (uint32_t)-1 }, /* Socket 2 Cue 0 */
{       329426,       504177,        53546,       690514,       290698, (uint32_t)-1 }, /* Socket 2 Cue 1 */
{       522251,      2287698,      1365119,       692691,       318517, (uint32_t)-1 }, /* Socket 2 Cue 2 */
{      1292298,       444159,       153114,       694867,       320517, (uint32_t)-1 }, /* Socket 2 Cue 3 */
{      1251600,       469692,      1940734,       697044,       322517, (uint32_t)-1 }, /* Socket 2 Cue 4 */
{      2293530,       131909,      2893497,       716632,       324517, (uint32_t)-1 }, /* Socket 2 Cue 5 */
{       504177,       830332,      2679267,       263315,       179945, (uint32_t)-1 }, /* Socket 2 Cue 6 */
{      1403906,      1922402,       469692,       347748,       177278, (uint32_t)-1 }, /* Socket 2 Cue 7 */
{       683505,       813373,       683505,       349748,       171945, (uint32_t)-1 }, /* Socket 2 Cue 8 */
{ (uint32_t)-1,       570466,       588481,       351748,       163945, (uint32_t)-1 }, /* Socket 2 Cue 9 */
{ (uint32_t)-1,      2671540,      1834798,       408284,       169278, (uint32_t)-1 }, /* Socket 2 Cue 10 */
{ (uint32_t)-1,            0,      1679045,       410284,       174612, (uint32_t)-1 }, /* Socket 2 Cue 11 */
{ (uint32_t)-1,        21224, (uint32_t)-1,       412284,       166612, (uint32_t)-1 }, /* Socket 2 Cue 12 */
{ (uint32_t)-1,      2877921, (uint32_t)-1,       407213,       789837, (uint32_t)-1 }, /* Socket 2 Cue 13 */
{ (uint32_t)-1, (uint32_t)-1, (uint32_t)-1,      2462444,       792837, (uint32_t)-1 }, /* Socket 2 Cue 14 */
{ (uint32_t)-1, (uint32_t)-1, (uint32_t)-1,      2469044,       795837, (uint32_t)-1 }, /* Socket 2 Cue 15 */
{        79755,       355888,       385080,      2471244,       998586, (uint32_t)-1 }, /* Socket 3 Cue 0 */
{      2760823,       438709,            0,      2473444,      1001836, (uint32_t)-1 }, /* Socket 3 Cue 1 */
{      2444265,       294172,      1617702,      2464644,      1008336, (uint32_t)-1 }, /* Socket 3 Cue 2 */
{       656582,      2059893,      1773080,      2466844,      1011586, (uint32_t)-1 }, /* Socket 3 Cue 3 */
{      2001174,      1624434,      1587964,      2503638,      1057337, (uint32_t)-1 }, /* Socket 3 Cue 4 */
{      2546036,       268624,      1811461,      2505986,      1060587, (uint32_t)-1 }, /* Socket 3 Cue 5 */
{      1231188,       662582,       654582,      2868175,      1095237, (uint32_t)-1 }, /* Socket 3 Cue 6 */
{      1025454,       469692,      2405062,      2871748,      1104987, (uint32_t)-1 }, /* Socket 3 Cue 7 */
{        39093,       270530,       764695,      2873262,      1111487, (uint32_t)-1 }, /* Socket 3 Cue 8 */
{       504177, (uint32_t)-1,       213885,      2880110,      1124487, (uint32_t)-1 }, /* Socket 3 Cue 9 */
{ (uint32_t)-1, (uint32_t)-1,       504177,      2884317,      1127737, (uint32_t)-1 }, /* Socket 3 Cue 10 */
{ (uint32_t)-1, (uint32_t)-1, (uint32_t)-1,      2887741,      1130987, (uint32_t)-1 }, /* Socket 3 Cue 11 */
{ (uint32_t)-1, (uint32_t)-1, (uint32_t)-1,      2927656,      1137487, (uint32_t)-1 }, /* Socket 3 Cue 12 */
{ (uint32_t)-1, (uint32_t)-1, (uint32_t)-1,      2930395,       851705, (uint32_t)-1 }, /* Socket 3 Cue 13 */
{ (uint32_t)-1, (uint32_t)-1, (uint32_t)-1,      2932547,       855105, (uint32_t)-1 }, /* Socket 3 Cue 14 */
{ (uint32_t)-1, (uint32_t)-1, (uint32_t)-1,      2935580,       858505, (uint32_t)-1 }, /* Socket 3 Cue 15 */
{       417341, (uint32_t)-1, (uint32_t)-1,      2965248,       861905, (uint32_t)-1 }, /* Socket 4 Cue 0 */
{       418341, (uint32_t)-1, (uint32_t)-1,      2885630,       865305, (uint32_t)-1 }, /* Socket 4 Cue 1 */
{       419341, (uint32_t)-1, (uint32_t)-1,      2889524,       868705, (uint32_t)-1 }, /* Socket 4 Cue 2 */
{       420341, (uint32_t)-1, (uint32_t)-1,      2869831,      1662424, (uint32_t)-1 }, /* Socket 4 Cue 3 */
{       421341, (uint32_t)-1, (uint32_t)-1,      2041018,      1665066, (uint32_t)-1 }, /* Socket 4 Cue 4 */
{       422341, (uint32_t)-1, (uint32_t)-1,      2044018,      1671206, (uint32_t)-1 }, /* Socket 4 Cue 5 */
{       423341, (uint32_t)-1, (uint32_t)-1,      2047018,      1679228, (uint32_t)-1 }, /* Socket 4 Cue 6 */
{       802471, (uint32_t)-1, (uint32_t)-1,      2050018,      1703881, (uint32_t)-1 }, /* Socket 4 Cue 7 */
{       803009, (uint32_t)-1, (uint32_t)-1,      2053018,      1710548, (uint32_t)-1 }, /* Socket 4 Cue 8 */
{       803548, (uint32_t)-1, (uint32_t)-1,      2056018,      1713881, (uint32_t)-1 }, /* Socket 4 Cue 9 */
{       804086, (uint32_t)-1, (uint32_t)-1,      2377407,      1707214, (uint32_t)-1 }, /* Socket 4 Cue 10 */
{       804625, (uint32_t)-1, (uint32_t)-1,      2387407,      1767286, (uint32_t)-1 }, /* Socket 4 Cue 11 */
{       805163, (uint32_t)-1, (uint32_t)-1,      2347407,      1769243, (uint32_t)-1 }, /* Socket 4 Cue 12 */
{       805702, (uint32_t)-1, (uint32_t)-1,      2357407,      1779579, (uint32_t)-1 }, /* Socket 4 Cue 13 */
{      2956998, (uint32_t)-1, (uint32_t)-1,      2367407,      1787404, (uint32_t)-1 }, /* Socket 4 Cue 14 */
{      2956998, (uint32_t)-1, (uint32_t)-1,       120059,       479601, (uint32_t)-1 }, /* Socket 4 Cue 15 */
{      2956998, (uint32_t)-1, (uint32_t)-1,       594092,      2961085, (uint32_t)-1 }, /* Socket 5 Cue 0 */
{      2956998, (uint32_t)-1, (uint32_t)-1,       629788,      2961207, (uint32_t)-1 }, /* Socket 5 Cue 1 */
{      2956998, (uint32_t)-1, (uint32_t)-1,       673688,      2961330, (uint32_t)-1 }, /* Socket 5 Cue 2 */
{      2956998, (uint32_t)-1, (uint32_t)-1,       686161,      2961452, (uint32_t)-1 }, /* Socket 5 Cue 3 */
{      2956998, (uint32_t)-1, (uint32_t)-1,       699220,      2961575, (uint32_t)-1 }, /* Socket 5 Cue 4 */
{      2962305, (uint32_t)-1, (uint32_t)-1,       701397,      2961820, (uint32_t)-1 }, /* Socket 5 Cue 5 */
{      2962305, (uint32_t)-1, (uint32_t)-1,       703573,      2961942, (uint32_t)-1 }, /* Socket 5 Cue 6 */
{      2962305, (uint32_t)-1, (uint32_t)-1,       705750,      2962065, (uint32_t)-1 }, /* Socket 5 Cue 7 */
{      2962305, (uint32_t)-1, (uint32_t)-1,       718809,      2962187, (uint32_t)-1 }, /* Socket 5 Cue 8 */
{      2962305, (uint32_t)-1, (uint32_t)-1,      2110301,      2962309, (uint32_t)-1 }, /* Socket 5 Cue 9 */
{      2962305, (uint32_t)-1, (uint32_t)-1,      2114968,      2962554, (uint32_t)-1 }, /* Socket 5 Cue 10 */
{      2962305, (uint32_t)-1, (uint32_t)-1,      2117301,      2962677, (uint32_t)-1 }, /* Socket 5 Cue 11 */
{ (uint32_t)-1, (uint32_t)-1, (uint32_t)-1,      2124301,      2962799, (uint32_t)-1 }, /* Socket 5 Cue 12 */
{ (uint32_t)-1, (uint32_t)-1, (uint32_t)-1,      2168868,      2962922, (uint32_t)-1 }, /* Socket 5 Cue 13 */
{ (uint32_t)-1, (uint32_t)-1, (uint32_t)-1,      2174942,      2963044, (uint32_t)-1 }, /* Socket 5 Cue 14 */
{ (uint32_t)-1, (uint32_t)-1, (uint32_t)-1,      2177979,      2963167, (uint32_t)-1 }, /* Socket 5 Cue 15 */
{       901605, (uint32_t)-1,       431341,      2184053,      2963289, (uint32_t)-1 }, /* Socket 6 Cue 0 */
{       902155, (uint32_t)-1,       432341,      2187090,      2963412, (uint32_t)-1 }, /* Socket 6 Cue 1 */
{       902705, (uint32_t)-1,       433341,      2190127,      2963534, (uint32_t)-1 }, /* Socket 6 Cue 2 */
{       903255, (uint32_t)-1,       434341,      2193164,      2963656, (uint32_t)-1 }, /* Socket 6 Cue 3 */
{       903805, (uint32_t)-1,       435341,      2196201,      2963779, (uint32_t)-1 }, /* Socket 6 Cue 4 */
{       904355, (uint32_t)-1,       436341,      2223534,      2964024, (uint32_t)-1 }, /* Socket 6 Cue 5 */
{       904905, (uint32_t)-1,       437341,      2229608,      2964146, (uint32_t)-1 }, /* Socket 6 Cue 6 */
{       909230, (uint32_t)-1,       809471,      2241756,      2964269, (uint32_t)-1 }, /* Socket 6 Cue 7 */
{       908680, (uint32_t)-1,       808933,        52254,      2964391, (uint32_t)-1 }, /* Socket 6 Cue 8 */
{       908130, (uint32_t)-1,       808394,        28383,      2964514, (uint32_t)-1 }, /* Socket 6 Cue 9 */
{       907580, (uint32_t)-1,       807856,        31416,      2964636, (uint32_t)-1 }, /* Socket 6 Cue 10 */
{       907030, (uint32_t)-1,       807317,       113309,      2964881, (uint32_t)-1 }, /* Socket 6 Cue 11 */
{       906480, (uint32_t)-1,       806779,       122309,      2965371, (uint32_t)-1 }, /* Socket 6 Cue 12 */
{       905930, (uint32_t)-1,       806240,       126809,      2965493, (uint32_t)-1 }, /* Socket 6 Cue 13 */
{       424341, (uint32_t)-1,      2956998,       131309,      2965738, (uint32_t)-1 }, /* Socket 6 Cue 14 */
{       425341, (uint32_t)-1,      2956998,       115559,      2965861, (uint32_t)-1 }, /* Socket 6 Cue 15 */
{       426341, (uint32_t)-1,      2956998,       124559,      2965983, (uint32_t)-1 }, /* Socket 7 Cue 0 */
{       427341, (uint32_t)-1,      2956998,       129059,      2966228, (uint32_t)-1 }, /* Socket 7 Cue 1 */
{       428341, (uint32_t)-1,      2956998,      1837694,      2966350, (uint32_t)-1 }, /* Socket 7 Cue 2 */
{       429341, (uint32_t)-1,      2956998,      1839694,      2966595, (uint32_t)-1 }, /* Socket 7 Cue 3 */
{       430341, (uint32_t)-1,      2956998,      1841694,      2966718, (uint32_t)-1 }, /* Socket 7 Cue 4 */
{      2952228, (uint32_t)-1,      2962305,      1843694,      2966840, (uint32_t)-1 }, /* Socket 7 Cue 5 */
{      2952228, (uint32_t)-1,      2962305,      1845694,      2966963, (uint32_t)-1 }, /* Socket 7 Cue 6 */
{      2952228, (uint32_t)-1,      2962305,      2297363,      2967085, (uint32_t)-1 }, /* Socket 7 Cue 7 */
{      2952228, (uint32_t)-1,      2962305,      2300488,      2964758, (uint32_t)-1 }, /* Socket 7 Cue 8 */
{      2952228, (uint32_t)-1,      2962305,      2303613,      2965003, (uint32_t)-1 }, /* Socket 7 Cue 9 */
{      2952228, (uint32_t)-1,      2962305,      2306738,      2962432, (uint32_t)-1 }, /* Socket 7 Cue 10 */
{      2952228, (uint32_t)-1,      2962305,      2309863,      2965616, (uint32_t)-1 }, /* Socket 7 Cue 11 */
{ (uint32_t)-1, (uint32_t)-1, (uint32_t)-1,      2312988,      2966105, (uint32_t)-1 }, /* Socket 7 Cue 12 */
{ (uint32_t)-1, (uint32_t)-1, (uint32_t)-1,      2316113,      2965126, (uint32_t)-1 }, /* Socket 7 Cue 13 */
{ (uint32_t)-1, (uint32_t)-1, (uint32_t)-1,      2319238,      2963901, (uint32_t)-1 }, /* Socket 7 Cue 14 */
{ (uint32_t)-1, (uint32_t)-1, (uint32_t)-1,      2322363,      2961697, (uint32_t)-1 } /* Socket 7 Cue 15 */

#if 0
0 duplicate cues with different firing times.
0 cues found with missing firing data.
470 cues added to program.


Expected scan response:
Remote-0 scan response:
Socket 0: Q00 Q01 Q02 Q03 Q04 Q05 Q06 Q07 Q08 Q09
Socket 1: Q00 Q01 Q02 Q03 Q04 Q05 Q06 Q07 Q08 Q09 Q10 Q11
Socket 2: Q00 Q01 Q02 Q03 Q04 Q05 Q06 Q07 Q08
Socket 3: Q00 Q01 Q02 Q03 Q04 Q05 Q06 Q07 Q08 Q09
Socket 4: Q00 Q01 Q02 Q03 Q04 Q05 Q06 Q07 Q08 Q09 Q10 Q11 Q12 Q13 Q14 Q15
Socket 5: Q00 Q01 Q02 Q03 Q04 Q05 Q06 Q07 Q08 Q09 Q10 Q11
Socket 6: Q00 Q01 Q02 Q03 Q04 Q05 Q06 Q07 Q08 Q09 Q10 Q11 Q12 Q13 Q14 Q15
Socket 7: Q00 Q01 Q02 Q03 Q04 Q05 Q06 Q07 Q08 Q09 Q10 Q11
Remote-1 scan response:
Socket 0: Q00 Q01 Q02 Q03 Q04 Q05 Q06 Q07 Q08 Q09
Socket 1: Q00 Q01 Q02 Q03 Q04 Q05 Q06 Q07 Q08 Q09 Q10 Q11 Q12
Socket 2: Q00 Q01 Q02 Q03 Q04 Q05 Q06 Q07 Q08 Q09 Q10 Q11 Q12 Q13
Socket 3: Q00 Q01 Q02 Q03 Q04 Q05 Q06 Q07 Q08
Socket 4:
Socket 5:
Socket 6:
Socket 7:
Remote-2 scan response:
Socket 0: Q00 Q01 Q02 Q03 Q04 Q05 Q06 Q07 Q08 Q09 Q10
Socket 1: Q00 Q01 Q02 Q03 Q04 Q05 Q06 Q07 Q08
Socket 2: Q00 Q01 Q02 Q03 Q04 Q05 Q06 Q07 Q08 Q09 Q10 Q11
Socket 3: Q00 Q01 Q02 Q03 Q04 Q05 Q06 Q07 Q08 Q09 Q10
Socket 4:
Socket 5:
Socket 6: Q00 Q01 Q02 Q03 Q04 Q05 Q06 Q07 Q08 Q09 Q10 Q11 Q12 Q13 Q14 Q15
Socket 7: Q00 Q01 Q02 Q03 Q04 Q05 Q06 Q07 Q08 Q09 Q10 Q11
Remote-3 scan response:
Socket 0: Q00 Q01 Q02 Q03 Q04 Q05 Q06 Q07 Q08 Q09 Q10 Q11 Q12 Q13 Q14 Q15
Socket 1: Q00 Q01 Q02 Q03 Q04 Q05 Q06 Q07 Q08 Q09 Q10 Q11 Q12 Q13 Q14 Q15
Socket 2: Q00 Q01 Q02 Q03 Q04 Q05 Q06 Q07 Q08 Q09 Q10 Q11 Q12 Q13 Q14 Q15
Socket 3: Q00 Q01 Q02 Q03 Q04 Q05 Q06 Q07 Q08 Q09 Q10 Q11 Q12 Q13 Q14 Q15
Socket 4: Q00 Q01 Q02 Q03 Q04 Q05 Q06 Q07 Q08 Q09 Q10 Q11 Q12 Q13 Q14 Q15
Socket 5: Q00 Q01 Q02 Q03 Q04 Q05 Q06 Q07 Q08 Q09 Q10 Q11 Q12 Q13 Q14 Q15
Socket 6: Q00 Q01 Q02 Q03 Q04 Q05 Q06 Q07 Q08 Q09 Q10 Q11 Q12 Q13 Q14 Q15
Socket 7: Q00 Q01 Q02 Q03 Q04 Q05 Q06 Q07 Q08 Q09 Q10 Q11 Q12 Q13 Q14 Q15
Remote-4 scan response:
Socket 0: Q00 Q01 Q02 Q03 Q04 Q05 Q06 Q07 Q08 Q09 Q10 Q11 Q12 Q13 Q14 Q15
Socket 1: Q00 Q01 Q02 Q03 Q04 Q05 Q06 Q07 Q08 Q09 Q10 Q11 Q12 Q13 Q14 Q15
Socket 2: Q00 Q01 Q02 Q03 Q04 Q05 Q06 Q07 Q08 Q09 Q10 Q11 Q12 Q13 Q14 Q15
Socket 3: Q00 Q01 Q02 Q03 Q04 Q05 Q06 Q07 Q08 Q09 Q10 Q11 Q12 Q13 Q14 Q15
Socket 4: Q00 Q01 Q02 Q03 Q04 Q05 Q06 Q07 Q08 Q09 Q10 Q11 Q12 Q13 Q14 Q15
Socket 5: Q00 Q01 Q02 Q03 Q04 Q05 Q06 Q07 Q08 Q09 Q10 Q11 Q12 Q13 Q14 Q15
Socket 6: Q00 Q01 Q02 Q03 Q04 Q05 Q06 Q07 Q08 Q09 Q10 Q11 Q12 Q13 Q14 Q15
Socket 7: Q00 Q01 Q02 Q03 Q04 Q05 Q06 Q07 Q08 Q09 Q10 Q11 Q12 Q13 Q14 Q15
Remote-5 scan response:
Socket 0:
Socket 1:
Socket 2:
Socket 3:
Socket 4:
Socket 5:
Socket 6:
Socket 7:
#endif